#define	AT2SO	1
/*
 * what: rx2at - RC receiver servo signal to ASCII conversion
 * who:	 miru
 * when: April 2011...
 */
#include <avr/interrupt.h>
#include <avr/pgmspace.h>
#include <avr/boot.h>
const char version[] PROGMEM = "0.23 20161207";

/* Receiver type: PARALLEL 0-std, 1-rev, 2-cust mount  SERIAL 3-AETR56 */
#define	RX_CON	0

/* switch setup, S_GEAR-(2 pos), S_AUX1-(2 or 3 pos) *
 * S_LAND S_FMOD
 * S_AUX1 S_AUX1 one 3 position switch (e.g. DX7)
 * S_GEAR S_GEAR one 2 position switch
 * S_GEAR S_AUX1 two switches (e.g. DX6)
 * S_AUX1 S_GEAR two switches */
#define	S_LAND	S_AUX1
#define	S_FMOD	S_AUX1

/* transmitter mode, function assignment of sticks
 * T_MODE 1 -> left: V-ELEV H-RUDD right: V-THRO H-AILE
 * T_MODE 4 -> left: V-THRO H-AILE right: V-ELEV H-RUDD
 * T_MODE 2 -> left: V-THRO H-RUDD right: V-ELEV H-AILE, US common mode
 * T_MODE 3 -> left: V-ELEV H-AILE right: V-THRO H-RUDD, US reversed */
#define	T_MODE	2

/* drone configuration choices
 * outdoor:     FALSE or TRUE, use (0 or 1)
 * no_shell:    FALSE or TRUE, use (0 or 1)
 * max_euler:   0.0 ... 0.52 max pitch/roll angle [rad]
 * max_vz:      200 ... 2000 max climb speed [mm/s]
 * max_yaw      0.7 ... 6.11 max yaw speed [rad/s]
 * max_alt:     altitude limit [m] (0 is off)
 * animation:   0 - disable, enabled otherwise
 * videorecord: 0 - disable, 1 - enable (NOOP on Drone 1 or Drone 2 without USB stick)
 * dcat:        TX/RX disconnect action deferral [sec]
 *            outdoor,no_shell,max_euler,max_vz,max_yaw,max_alt,anim,rvid,dcat */
const char cfg1[] PROGMEM = "1,1,0.35,2000,3.5,0,1,1,30";	/* S standard */
const char cfg2[] PROGMEM = "1,1,0.52,2000,6.1,0,1,1,30";	/* W wild (max) */
const char cfg3[] PROGMEM = "0,0,0.21,700,1.75,2,0,0,5";	/* N normal */
const char cfg4[] PROGMEM = "0,0,0.10,700,1.50,2,0,0,5";	/* E easy */

/* VLBA output, Visible Low Battery Alert
 * the program can watch the battery capacity (percentage) on the drone, if it
 * goes below VLBA_THR the VLBA mechanism triggers. The drone's LEDs flash in RED
 * and VLBA output gets activated (blinking or steady), set to 0 to turn VLBA off */
#define	VLBA_THR	15	/* 0 or > 60 turns it off */
#define	VLBA_POL	1	/* 1-active high, 0-active low */
#define	VLBA_BLINK	1	/* 1-blink, 0-no blink */

/* GSWO output, you can route the GEAR channel status to this output to switch
 * something ON/OFF or use it as the output of the BEEP sequencer */
#define	GSWO_ENA	-1	/* -1 disable, 0 active low, 1 active high */
#define	GSWO_SRC	0	/* 0 - GEAR channel, 1 - BEEP output */

/* Arduino LED: 1 to turn off when airborne */
#define	NL_AIR	0

#define	LOOPHZ	30	/* loop frequency */
#define	S2LTIC(s)	(u08_t)((double)LOOPHZ*(double)(s)+0.5)


#if defined(__AVR_ATmega328P__)
#define	U4	0
/* Arduino Nano and ProMini */
/* LABEL PORT  DIR description
 *   RX0 PD.0  IN  UART receive
 *   TX1 PD.1  OUT UART transmit
 *   D2  PD.2  IN  RX parallel AUX1 channel
 *   D3  PD.3  IN  RX parallel GEAR channel, RX serial PPM signal
 *   D4  PD.4  IN  RX parallel RUDD channel
 *   D5  PD.5  IN  RX parallel ELEV channel
 *   D6  PD.6  IN  RX parallel AILE channel
 *   D7  PD.7  IN  RX parallel THRO channel
 * LABEL PORT  DIR description
 *   D8  PB.0
 *   D9  PB.1  OUT VLBA
 *   D10 PB.2  OUT GSWO (if GSWO_ENA >= 0)
 *   D11 PB.3  IN  SETUP input
 *   D12 PB.4
 *   D13 PB.5  OUT (LED,   Arduino comes this way)
 *   -   PB.6  -   (quarz, Arduino comes this way)
 *   -   PB.7  -   (quarz, Arduino comes this way)
 * LABEL PORT  DIR description
 *   A0  PC.0  IN  GPS RX
 *   A1  PC.1  OUT GPS TX
 *   A2  PC.2
 *   A3  PC.3  
 *   A4  PC.4  I/O (SDA two wire interface)
 *   A5  PC.5  I/O (SCL two wire interface)
 *   A6  -         (analog input 6, Nano and newer ProMini)
 *   A7  -         (analog input 7, Nano and newer ProMini)
 *
 * TIMER0: 'soft' serial port for GPS
 * TIMER1: system clock
 * TIMER2: not used
 */
#define	SIO_UDR		UDR0
#define	SIO_RX_VECT	USART_RX_vect
#define	SIO_TX_VECT	USART_UDRE_vect
#define	SIO_UCSRA	UCSR0A
#define	SIO_UCSRB	UCSR0B
#define	SIO_UCSRC	UCSR0C
#define	SIO_UBRR	UBRR0
#define	SIO_U2X		U2X0
#define	SIO_UDRIE	UDRIE0
#define	SIO_RXCIE	RXCIE0
#define	SIO_RXEN	RXEN0
#define	SIO_TXEN	TXEN0
#define	PIN_CHG_IRQEN()	PCICR |= _BV(PCIE2)|_BV(PCIE1)

#elif defined(__AVR_ATmega32U4__)
#define	U4	1
/* MiruPCB board layout
 * LABEL PORT  notes         DIR description
 *       PB.0
 * B1    PB.1  (SCK)         IN  RX parallel THRO
 * B2    PB.2  (MOSI)        IN  RX parallel AILE
 * B3    PB.3  (MISO)        IN  RX parallel ELEV
 * B4    PB.4                IN  RX parallel RUDD
 * B5    PB.5                IN  RX parallel GEAR
 * B6    PB.6                IN  RX parallel AUX1, RX serial PPM signal
 * RST   PB.7                (O) RESET*
 * LABEL PORT  notes         DIR description
 *       PC.6
 * LED   PC.7  LED green     OUT activity LED
 * LABEL PORT  notes         DIR description
 * SCL   PD.0  (SCL)         I/O (two wire interface)
 * SDA   PD.1  (SDA)         I/O (two wire interface)
 *       PD.2  (UART RX)     IN  UART receive
 *       PD.3  (UART TX)     OUT UART transmit
 * GTX   PD.4                OUT GPS  transmit
 *       PD.5
 * VLBA  PD.6                OUT VLBA
 * GSWO  PD.7                OUT GSWO
 * LABEL PORT  notes         DIR description
 *       PE.2  (HWB)
 * GRX   PE.6  (INT6)        IN  GPS receive
 * LABEL PORT  notes         DIR description
 *       PF.0
 *       PF.1
 *       PF.4
 *       PF.5
 *       PF.6               (OUT debug signal 1)
 *       PF.7               (OUT debug signal 0)
 *
 * TIMER0: 'soft' serial port for GPS
 * TIMER1: system clock
 * TIMER2: not used
 */
#define	SIO_UDR		UDR1
#define	SIO_RX_VECT	USART1_RX_vect
#define	SIO_TX_VECT	USART1_UDRE_vect
#define	SIO_UCSRA	UCSR1A
#define	SIO_UCSRB	UCSR1B
#define	SIO_UCSRC	UCSR1C
#define	SIO_UBRR	UBRR1
#define	SIO_U2X		U2X1
#define	SIO_UDRIE	UDRIE1
#define	SIO_RXCIE	RXCIE1
#define	SIO_RXEN	RXEN1
#define	SIO_TXEN	TXEN1
#define	PIN_CHG_IRQEN()	PCICR |= _BV(PCIE0), EIFR |= _BV(6)

#else
#error "sorry, processor not supported"
#endif

/* NOOPs, get redefined if needed */
#define	usb_sq()

void port_setup(void)
{
#if	U4 == 0		/* is Arduino Nano or ProMini */
	PORTB = 0b00000000;
	DDRB  = 0b00000000;

/* (label 13 on Arduino) HW comes with a LED on this pin */
#define	LED	_BV(5)
#define	LEDON()	PORTB |=  LED
#define	LEDOF()	PORTB &= ~LED
#define	LEDTG()	PORTB ^=  LED
	DDRB |= LED;	/* output */

/* (label 11 on Arduino) ground for SETUP */
	PORTB |= _BV(3);	/* enable pull-up */
#define	SETUP() ((PINB & _BV(3)) == 0)

/* (label 10 on Arduino) reflects GSWO_SRC if enabled */
#define	GSWO	_BV(2)
#if	GSWO_ENA >= 0
	#if	GSWO_ENA > 0
	#define	GSWON()	PORTB |=  GSWO
	#define	GSWOF()	PORTB &= ~GSWO
	#else
	#define	GSWON()	PORTB &= ~GSWO
	#define	GSWOF()	PORTB |=  GSWO
	#endif
	DDRB |= GSWO;	/* output */
	GSWOF();
#else
	#define	GSWON()
	#define	GSWOF()
#endif

/* (label  9 on Arduino) VLBA output pin */
#define	VLBA	_BV(1)
#if	VLBA_POL == 1
#define	VLBON()	PORTB |=  VLBA
#define	VLBOF()	PORTB &= ~VLBA
#else
#define	VLBOF()	PORTB |=  VLBA
#define	VLBON()	PORTB &= ~VLBA
#endif
#define	VLBTG()	PORTB ^=  VLBA
	VLBOF();
	DDRB |= VLBA;	/* output */

/* I2C interface */
	PORTC = 0b00000000;
	PORTC |= _BV(5)|_BV(4);	/* enable pullups for SDA/SCL */
	DDRC  = 0b00000000;

/* (label A0 on Arduino) GPS serial port in */
#define	GPS_RXI_VECT	PCINT1_vect
#define	GPS_RXI	_BV(0)
#define	GPS_RXI_INPUT()	(PINC & GPS_RXI)
#define	GPS_RXI_IRQON()	PCMSK1 |=  GPS_RXI
#define	GPS_RXI_IRQOF()	PCMSK1 &= ~GPS_RXI
	PORTC |=  GPS_RXI;	/* enable pullup on RXI */

/* (label A1 on Arduino) GPS serial port out */
#define	GPS_TXO	_BV(1)
#define	GPS_TXO_SET()	PORTC |=  GPS_TXO
#define	GPS_TXO_CLR()	PORTC &= ~GPS_TXO
#define	GPS_TXO_VAL()	(PORTC & GPS_TXO)
	DDRC  |=  GPS_TXO;	/* TXO is output */
	PORTC |=  GPS_TXO;	/* set TXO idle */

#define	RXSIG_VECT	PCINT2_vect
#define	RXSIG		PIND
#if	RX_CON == 3
#define	RXMSK		(_BV(3))
#else
#define	RXMSK		(_BV(7)|_BV(6)|_BV(5)|_BV(4)|_BV(3)|_BV(2))
#endif
	PCMSK2 = RXMSK;
	PORTD =  RXMSK|03;   	/* enable pull-ups for receiver inputs, and UART signals */
	DDRD  = 0b00000000;


#else	/* is MiruPCB */
#define	RXSIG_VECT	PCINT0_vect
#define	RXSIG		PINB
#if	RX_CON == 3
#define	RXMSK		(_BV(6))
#else
#define	RXMSK		(_BV(6)|_BV(5)|_BV(4)|_BV(3)|_BV(2)|_BV(1))
#endif
	PCMSK0 = RXMSK;
	PORTB  = RXMSK;	/* enable pull-ups for receiver */
	DDRB   = 0b00000000;

	PORTC = 0b00000000;
	DDRC  = 0b00000000;
/* HW comes with a LED on this pin */
#define LED	_BV(7)
#define	LEDON()	PORTC |=  LED
#define	LEDOF()	PORTC &= ~LED
#define	LEDTG()	PORTC ^=  LED
	DDRC  |= LED;	/* output */

/* I2C interface */
	PORTD = 0b00001111;   	/* enable pull-ups for UART and I2C signals */
	DDRD  = 0b00000000;
/* GSWO output pin */
#define	GSWO	_BV(7)
#if	GSWO_ENA >= 0
	#if	GSWO_ENA > 0
	#define	GSWON()	PORTD |=  GSWO
	#define	GSWOF()	PORTD &= ~GSWO
	#else
	#define	GSWON()	PORTD &= ~GSWO
	#define	GSWOF()	PORTD |=  GSWO
	#endif
	DDRD  |= GSWO;	/* output */
#else
	#define	GSWON()
	#define	GSWOF()
#endif
	GSWOF();
/* VLBA output pin */
#define	VLBA	_BV(6)
#if	VLBA_POL == 1
#define	VLBON()	PORTD |=  VLBA
#define	VLBOF()	PORTD &= ~VLBA
#else
#define	VLBOF()	PORTD |=  VLBA
#define	VLBON()	PORTD &= ~VLBA
#endif
#define	VLBTG()	PORTD ^=  VLBA
	VLBOF();
	DDRD  |= VLBA;		/* output */
/* GPS serial port out */
#define	GPS_TXO	_BV(4)
#define	GPS_TXO_SET()	PORTD |=  GPS_TXO
#define	GPS_TXO_CLR()	PORTD &= ~GPS_TXO
#define	GPS_TXO_VAL()	(PORTD & GPS_TXO)
	PORTD |= GPS_TXO;	/* set TXO idle */
	DDRD  |= GPS_TXO;	/* output */

	PORTE = 0b00000000;
/* GPS serial port in */
#define	GPS_RXI_VECT	INT6_vect
#define	GPS_RXI	_BV(6)
#define	GPS_RXI_INPUT()	(PINE & GPS_RXI)
#define	GPS_RXI_IRQON()	EIMSK |=  GPS_RXI
#define	GPS_RXI_IRQOF()	EIMSK &= ~GPS_RXI
	PORTE |= GPS_RXI;	/* enable pullup on RXI */
	DDRE  = 0b00000000;
	EICRB = 0b00010000;	/* -,-,isc61,ISC60,-,-,-,- */

	PORTF = 0b00000000;
	DDRF  = 0b00000000;
#endif

	MCUCR = 0b00000000;	/* PUD=0 clear global pull-up disable */
}

void sio_setup(void)
{
	SIO_UCSRB = 0b00000000;	/* rxcie0,txcie0,udrie0,rxen0,txen0,ucsz02,rxb80,txb80 */
	SIO_UCSRC = 0b00000110;	/* umsel01,umsel00,upm01,upm00,usbs0,UCSZ01,UCSZ00,ucpol0 */
	SIO_UCSRA = 0b00000000;	/* rxc0,txc0,udre0,fe0,dor0,upe0,u2x0,mpcm0 */
#if	F_CPU == 16000000UL	/* (see NOTES USART) */
	SIO_UBRR  = 16;
	SIO_UCSRA |= _BV(SIO_U2X);
#else
	SIO_UBRR  = (F_CPU/(16UL*115200UL)-1);
#endif
}

void tmr1_setup(void)
{
#define	F_TM1		(F_CPU/8UL)	/* (see NOTES TIMER1) */
#define	MS2TIC(ms)	(u32_t)((double)F_TM1*(double)(ms)*1e-3)
#define	TIC2MS(tic)	(u32_t)((tic)/(F_TM1/1000L))
#define	TIC2MS10(tic)	(u32_t)((tic)/(F_TM1/10000L))
#define	TIC2US(tic)	(u32_t)((tic)/(F_TM1/1000000L))

	TCCR1A = 0b00000000;	/* com1a1,com1a0,com1b1,com1b0,-,-,wgm11,wgm10 */
	TCCR1B = 0b00000010;	/* icnc1,ices1,-,wgm13,wgm12,cs12,CS11,cs10 F_CPU/8 */
	TCCR1C = 0b00000000;	/* foc1a,foc1b,-,-,-,-,-,- */
	TIMSK1 = 0b00000001;	/* -,-,icie1,-,-,ocie1b,ocie1a,TOIE1 */
}

#define	NEL(x)		(sizeof(x)/sizeof(x[0]))
#define	ABS(x)		((x)>=0?(x):-(x))
#define	MIN(a,b)	((a)<=(b)?(a):(b))
#define	LIMIT(mn,mx,v)	((v)<(mn)?(mn):(v)>(mx)?(mx):(v))
/* circular buffers */
#define	CB_FILL(r,w,s)	(((w)-(r)+(s))%(s))	/* available elements for get */
#define	CB_FREE(r,w,s)	(((r)-(w)+(s)-1)%(s))	/* available elements for put */
#define	CB_HASD(r,w)	((r)!=(w))		/* has data */
#define	CB_NO_D(r,w)	((r)==(w))		/* has no data */

typedef char		s08_t;
typedef volatile s08_t	vs08_t;
typedef unsigned char	u08_t;
typedef volatile u08_t	v08_t;
typedef unsigned short	u16_t;
typedef volatile u16_t	v16_t;
typedef unsigned long	u32_t;

typedef struct {
	u32_t	dcst;	/* drone status */
	char	cbat;	/* battery percentage left */
	char	beep;
	char	sgps;	/* GPS status */
}	__attribute__ ((packed)) m2a_t;

typedef struct {	/* radio signal sample */
	u08_t	smp;
	u32_t	tmr;	/* time stamp */
}	__attribute__ ((packed)) rsm_t;

struct {
	v16_t	t1ov;	/* timer 1 overflow count */
	v16_t	dcnt;	/* delay count for ms_dly() */
	u08_t	exit;
	u08_t	alin;

	struct { /* UART is connected to drone */
		/* circular receive buffer (r == w -> empty) */
		v08_t	rxw;
		v08_t	rxr;
		u08_t	rxb[32];
		/* circular transmit buffer (r == w -> empty) */
		v08_t	txw;
		v08_t	txr;
		u08_t	txb[200];
	}	sio;

#if	U4
	struct { /* FTDI simulation */
		u08_t	ep0a;	/* interface active */
		u08_t	ep0r;	/* EP0 received */
		union {	/* setup request packet */
			u08_t	b[8];
			struct {
				u08_t	bmRequestType;
				#define REQ_DIR	0x80
				#define  REQ_H2D	0x00
				#define  REQ_D2H	0x80
				#define REQ_TYP	0x60
				#define  REQ_STD	0x00
				#define  REQ_CLS	0x20
				#define  REQ_VEN	0x40
				#define REQ_DST	0x03
				#define  REQ_DEV	0x00
				#define  REQ_IFC	0x01
				#define  REQ_EPT	0x02
				#define  REQ_OTH	0x03
				u08_t	bRequest;
				#define GET_STATUS	0
				#define CLR_FEA		1
				#define SET_FEA		3
				#define SET_ADR		5
				#define GET_DSC		6
				#define SET_DSC		7
				#define GET_CFG		8
				#define SET_CFG		9
				#define GET_IFC		10
				#define SET_IFC		11
				u16_t	wValue;
				u16_t	wIndex;
				u16_t	wLength;
			};
		}	ep0b;
		/* EP1 management dev->host */
		u08_t	sofi;
		v08_t	ep1h;
		v08_t	ep1r;
		v08_t	ep1w;
		u08_t	ep1b[200];
		/* EP2 management host->dev */
		v08_t	ep2r;

		/* FTDI simulator */
		u08_t	mdst;	/* modem status */
		#define	MDST_RLSD	_BV(7)	/* receive line signal */
		#define	MDST_RI		_BV(6)	/* ring indicator */
		#define	MDST_DSR	_BV(5)	/* data set ready */
		#define	MDST_CTS	_BV(4)	/* clear to send */
		#define	MDST_RTS	_BV(3)	/* INTERNAL request to send */
		#define	MDST_DTR	_BV(2)	/* INTERNAL data terminal ready */
		#define	MDST(s)		((s)&~(MDST_RTS|MDST_DTR))
		#define	RST_MDST	(MDST_DSR|MDST_CTS|_BV(0))
		u08_t	lnst;	/* line status */
		#define	LNST_FIFO	_BV(7)	/* fifo error */
		#define	LNST_TEMT	_BV(6)	/* transmitter empty */
		#define	LNST_THRE	_BV(5)	/* transmit holding register enpty */
		#define	LNST_BI		_BV(4)	/* break interrupt */
		#define	LNST_FE		_BV(3)	/* framing error */
		#define	LNST_PE		_BV(2)	/* parity error */
		#define	LNST_OE		_BV(1)	/* overrun */
		#define	LNST_DR		_BV(0)	/* data ready */
		#define	RST_LNST	(LNST_TEMT|LNST_THRE|LNST_DR)
		#define	RUN_LNST	(LNST_TEMT|LNST_THRE|LNST_DR)
		u16_t	sfmt;	/* parity, number of bits */
		u16_t	baud;	/* speed */
		u16_t	tlat;	/* latency timer */
	}	usb;
#endif

	struct { /* messages from drone companion program */
		v08_t	ack;
		v08_t	cst;
		v08_t	nda;
		union {
			u08_t	b[0];
			m2a_t	m2a;
		}	dat;
		m2a_t	m2a;
	}	drm;

	struct { /* 'soft' serial port for GPS */
		int	b100;
		u08_t	tcnt;
		u08_t	thbt;
		u16_t	lstp;	/* sample of timer 1 at last stop bit */
		/* receiver */
		v08_t	rxi;	/* last value of input GPS_RXI */
		u08_t	rxm;	/* data bit mask register */
		u08_t	rxd;	/* data shift register */
		v08_t	rxw;
		v08_t	rxr;
		/* transmitter */
		u08_t	txm;
		u08_t	txd;
		v08_t	txe;
		v08_t	txw;
		v08_t	txr;
		/* GPS data assembly */
		u08_t	est;
		u08_t	ech;
		u08_t	cst;
		u08_t	cks;
		u08_t	seq;
		u08_t	b_r;
		u08_t	b_w;
		u08_t	b_s;
		u08_t	b_n;
		/* buffers */
		union {
			u32_t	rxt[95];	/* for baudrate detection */
			struct {
			u08_t	rxb[96];	/* buffers 24.7 ms on 38400 baud stream */
			u08_t	txb[32];
			char	buf[252];
			};
		};
	}	gps;

	struct {
		u08_t	stat;
		u08_t	tick;
	}	vlba;
#if	GSWO_ENA >= 0 && GSWO_SRC == 1
	struct {
		u08_t	nbp;
		u08_t	tmr;
		u08_t	seq;
	}	beep;
#endif

	struct { /* RC receiver signals */
		u08_t	err;	/* signals with errors */
		u08_t	erx;	/* consecutive error count rx_read() */

		u08_t	fms;	/* flight mode (rx_read()) */
#define	FMS_LAND	0
#define	FMS_FM_1	1	/* use camera for stabilization on ROL/PTC sticks centered */
#define	FMS_FM_2	2	/* idle up, don't use camera on ROL/PTC stick centered */
#define	FMS_FM_3	3	/* auto pilot mode */
		u08_t	fsq;	/* flight mode sequencer */
		u08_t	fst;	/* flight mode sequencer tic */
		u08_t	fsa;	/* flight mode sequencer animation trigger */

		u08_t	stk;	/* stick status (rx_read()) */
		u08_t	chg;	/* stick status change (dr_loop() private) */
#define	TS_RT	0x01
#define	TS_LF	0x02
#define	TS_UP	0x04
#define	TS_DN	0x08
#define	TS_MSK	0x0f
#define	ES_RT	0x10
#define	ES_LF	0x20
#define	ES_UP	0x40
#define	ES_DN	0x80
#define	ES_MSK	0xf0

		u08_t	smp;	/* last signal sample */
		u08_t	rsr;	/* read  index radio sampling buffer */
		u08_t	rsw;	/* write index radio sampling buffer */
		rsm_t	rsb[32];

/* AETR ordering for serial RX */
#define	S_AILE	0
#define	S_ELEV	1
#define	S_THRO	2
#define	S_RUDD	3
#define	S_GEAR	4
#define	S_AUX1	5
#define	S_NCHN	6
/* Note: independent of TX mode 1-4, throttle and elevator channels are never on the
 * same physical stick and are always controlled by vertical movement of the stick */
#if   T_MODE == 1 || T_MODE == 4
	#define	SH_THRO	S_AILE
	#define	SH_ELEV	S_RUDD
#else
	#define	SH_THRO	S_RUDD
	#define	SH_ELEV	S_AILE
#endif
#define	STKTHR	500	/* throttle/elevator stick threshold for switching */

		u32_t	lfs; /* [tic] last frame start */
		u32_t	ftm; /* [tic] frame time */
#if	RX_CON == 3
		struct {	/* serial RC receiver */
			v08_t	idx; /* serial RX pulse index */
			u32_t	ptd; /* [tic] last down transition processed */
		}	srx;
		struct chn {
			u32_t	tac; /* [tic] timer1 when signal activated */
			int	dur; /* [tic] measured pulse length */
			int	dbn; /* [tic] signal dead band */
			int	val; /* interpreted value (rx_read()) */
		}	chn[S_NCHN];
#else
		struct chn {
			u08_t	msk; /* port mask for signal */
			u32_t	tac; /* [tic] timer1 when signal activated */
			int	dur; /* [tic] measured pulse length */
			int	dbn; /* [tic] signal dead band */
			int	val; /* interpreted value (rx_read()) */
		}	chn[S_NCHN];
#endif
/* RX channel mapping to drone */
#define S_ROL	S_AILE
#define S_PTC	S_ELEV
#define S_GAZ	S_THRO
#define S_YAW	S_RUDD
/* RX channels used */
#if	GSWO_ENA >= 0
#define	S_SIG	(_BV(S_ROL)|_BV(S_PTC)|_BV(S_GAZ)|_BV(S_YAW)|_BV(S_AUX1)|_BV(S_GEAR))
#else
#define	S_SIG	(_BV(S_ROL)|_BV(S_PTC)|_BV(S_GAZ)|_BV(S_YAW)|_BV(S_LAND)|_BV(S_FMOD))
#endif
	}	rxs;

	/* drone companion program in flash */
	struct {
		u16_t	adr;
		u16_t	siz;
		u16_t	cks;
	}	arm;

	u08_t	dsnd;	/* snd_sc() destination, 0 sio, 1 usb */
	char	pad;	/* drone control <0 emergency, >0 fly, else land */
	char	cfw;	/* configuration wanted by telling from the sticks */
	u08_t	eewen;	/* EEROM */
	union {
		u08_t	eedat[6];
		struct {
			u16_t	eemag;
			u16_t	bid;	/* boot id */
			u08_t	cfg;
			u08_t	eecks;
		};
	};
#define	EE_MAG	0x2701
}	gl;

#if	GSWO_ENA >= 0 && GSWO_SRC == 1
void beep_sq(void)
{
	if (gl.beep.tmr && (gl.beep.tmr -= 1)) return;
	switch (gl.beep.seq) {
	case 0: if (gl.beep.nbp == 0) break;
		gl.beep.nbp -= 1;
		gl.beep.tmr = S2LTIC(0.25);
		gl.beep.seq = 1;
		GSWON();
		break;
	case 1: gl.beep.tmr = S2LTIC(0.25);
		gl.beep.seq = 0;
		GSWOF();
		break;
	}
}
#else
#define	beep_sq()
#endif

/*
 * How the 'soft' serial port for GPS works:
 * TIMER0 (8bit) is setup so it rolls on RS232 bit boundaries, this provides all that's
 * needed to do a transmitter with the timer rollover interrupt. The interrupt is turned
 * off when there is nothing to transmit.
 * To build a receiver at the same baudrate, the 1->0 transition of the RX input is used
 * to set the second compare register of the timer with the current timer value+some,
 * after that the compare interrupt becomes the sampling point for the RX input. Once a
 * byte is received, the RX transition interrupt is reenabled to wait for the next byte.
 */
void tmr0_setup(int b100)	/* argument is baudrate/100 */
{
	u16_t	cnt;
	u08_t	ccr;

	ccr = SREG; cli();
	TIMSK0 = 0b00000000;	/* -,-,-,-,-,ocie0b,ocie0a,toie0 */
	TCCR0A = 0b00000000;	/* com0a1,com0a0,com0b1,com0b0,-,-,wgm01,wgm00  */
	TCCR0B = 0b00000000;	/* foc0a,foc0b,-,-,wgm02,cs02,cs01,cs00  OFF */
	SREG = ccr;
	gl.gps.rxw = gl.gps.rxr = 0;
	gl.gps.txw = gl.gps.txr = 0;
	gl.gps.txe = 0;
	gl.gps.b100 = 0;
	gl.gps.tcnt = 0;
	gl.gps.thbt = 0;
	if (b100 <= 0) return;
	/* turn it on for baudrate b100 * 100 */
	gl.gps.txe = 1;
	cnt = (F_CPU/100UL)/(long)b100;
	for (ccr = 1; cnt >= 210L; cnt >>= 3) ccr++;
	if (ccr >= 5) return;
	gl.gps.b100 = b100;
	gl.gps.tcnt = cnt - 1;
	/* sampling offset relative to 1->0 transition of start bit */
	if (gl.gps.tcnt > 80)
		gl.gps.thbt = (cnt*50)/100;
	else	gl.gps.thbt = (cnt*15)/100;
	OCR0A  = gl.gps.tcnt;
	TCCR0B = ccr;
	TCCR0A = 0b00000010;	/* com0a1,com0a0,com0b1,com0b0,-,-,WGM01,wgm00  CTC mode */
}

ISR(TIMER1_OVF_vect)
{
	gl.t1ov++;
}

inline void itic(u16_t *t)	/* called with interrupts disabled */
{
	t[1] = gl.t1ov;
	t[0] = TCNT1;
	if ((TIFR1 & _BV(TOV1)) && t[0] < 0xffff) t[1]++;
}

u32_t tic(void)
{
	union { u16_t uw[2]; u32_t ul; } t;
	u08_t	srg;

	srg = SREG; cli();
	itic(t.uw);
	SREG = srg;
	return t.ul;
}

void ms_dly(int ndcnt)
{
	int	i;

	for (; ndcnt; ndcnt--)
		for (i = gl.dcnt; --i >= 0; )
			__asm__ __volatile__ ("nop");
}

void msdly_cali(void)
{
	u32_t	tmr;

	gl.dcnt = 2000;
	tmr = tic();
	ms_dly(100);
	tmr = tic() - tmr;
	gl.dcnt = (int)((200UL*F_TM1)/tmr);
}

void blip(unsigned char nb)
{
	while (nb--) {
		LEDON(); ms_dly( 20);
		LEDOF(); ms_dly(180);
	}
}

/*
 * EEPROM
 */
void eepr_save(void)
{
	u08_t	i;

	gl.eemag = EE_MAG;
	gl.eecks = 0;
	for (i = 0; i < (NEL(gl.eedat)-1); i++) gl.eecks += gl.eedat[i];
	gl.eewen = 0;
}

void eepr_updt(void)
{
	u08_t	t;

	if ((EECR & _BV(EEPE)) == 0) {
		EEAR = (int)gl.eewen;
		EEDR = gl.eedat[gl.eewen];
		t = SREG; cli();
		EECR = _BV(EEMPE);
		EECR |= _BV(EEPE);
		SREG = t;
		gl.eewen++;
	}
}

/*
 * uart receiver
 */
ISR(SIO_RX_VECT) /* receiver interrupt */
{
	u08_t	i;

	gl.sio.rxb[i = gl.sio.rxw] = SIO_UDR;
	if (++i >= NEL(gl.sio.rxb)) i = 0;
	if (i != gl.sio.rxr) gl.sio.rxw = i;
}

int sio_rc(void) /* read next character received */
{
	u08_t	i;
	int	b;

	if (CB_NO_D(gl.sio.rxr,gl.sio.rxw)) return -1;
	b = (int)gl.sio.rxb[i = gl.sio.rxr];
	gl.sio.rxr = ++i >= NEL(gl.sio.rxb) ? 0 : i;
	return b;
}

char sio_rf(void) /* flush sio receive buffer */
{
	if (gl.sio.rxr == gl.sio.rxw) return 0;
	gl.sio.rxr = gl.sio.rxw;
	return 1;
}

/*
 * uart transmitter
 */
ISR(SIO_TX_VECT) /* tx empty interrupt */
{
	u08_t	i;

	if (CB_HASD(gl.sio.txr,gl.sio.txw)) {
		SIO_UDR = gl.sio.txb[i = gl.sio.txr];
		gl.sio.txr = ++i >= NEL(gl.sio.txb) ? 0 : i;
	}
	if (CB_NO_D(gl.sio.txr,gl.sio.txw))
		SIO_UCSRB &= ~_BV(SIO_UDRIE); /* no more, disable TX IRQ */
}

void sio_sc(char c) /* send character */
{
	u08_t	i;

	gl.sio.txb[i = gl.sio.txw] = c;
	if (++i >= NEL(gl.sio.txb)) i = 0;
	if (i != gl.sio.txr) {
		gl.sio.txw = i;
		SIO_UCSRB |= _BV(SIO_UDRIE); /* enable TX IRQ */
	}
}

u08_t sio_tf(void) /* txb free space */
{
	return CB_FREE(gl.sio.txr,gl.sio.txw,NEL(gl.sio.txb));
}

void gps_rcv(void);

void sio_tw(void) /* wait for tx empty */
{
	do gps_rcv();
	while (CB_HASD(gl.sio.txr,gl.sio.txw));
}

void sio_ss(char *s) /* send string from ram */
{
	char	c;

	while ((c = *s++)) sio_sc(c);
}

void sio_sp(const char *p) /* send string from flash */
{
	char	c;

	while ((c = pgm_read_byte(p++))) sio_sc(c);
}

#define	SIO_SP(str)	sio_sp(PSTR(str))

void sio_rev(void)
{
	u08_t	n, k;

	for (n = 0; n < 5; n++) {
		k = pgm_read_byte(&version[n]);
		if (k == '.') continue;
		if (k == ' ') break;
		sio_sc(k);
	}
}

void snd_sc(char c)
{
#if	U4
	void usb_sc(char c);
	if (gl.dsnd) usb_sc(c); else
#endif
	sio_sc(c);
}

/*
 * convert to ASCII and transmit
 */
/* send hex */
void snd_snx(u08_t n) { n &= 0x0f; if (n <= 9) snd_sc('0'+n); else snd_sc('A'-10+n); }
void snd_sbx(u08_t b) { snd_snx(b>>4); snd_snx(b>>0); }
void snd_swx(u16_t w) { snd_sbx(w>>8); snd_sbx(w>>0); }

void snd_sid(char lc, int i) /* integer decimal */
{
	u08_t	fw, nd, sn, b[16];

	fw = sn = nd = 0;
	if (lc > 0) snd_sc(lc);		/* 'lc' is leading character */
	else if (lc < 0) fw = -lc;	/* 'lc' is field width */
	if (i < 0) i = -i, sn = '-';	/* sign */
	do b[nd++] = (i%10) + '0'; while ((i /= 10));
	if (sn) b[nd++] = sn;
	for (sn = nd; sn < fw; sn++) snd_sc(' ');
	do snd_sc(b[--nd]); while (nd);
}

void snd_spd(u08_t fw, u08_t pr, long i) /* pseudo decimal */
{
	u08_t	nd, sn, b[20];

	if (pr > 16) pr = 16;
	sn = nd = 0;
	if (i < 0) i = -i, sn = '-';
	do {
		b[nd++] = (i%10) + '0';
		if (nd == pr) b[nd++] = '.';
	}
	while ((i /= 10) || nd < pr);
	if (pr && (nd - pr) == 1) b[nd++] = '0';
	if (sn) b[nd++] = '-';
	while (nd < fw) fw--, snd_sc(' ');
	do snd_sc(b[--nd]); while (nd);
}

void snd_sp(const char *p) /* string from flash */
{
	char	c;

	while ((c = pgm_read_byte(p++))) snd_sc(c);
}

#define	SND_SP(str)	snd_sp(PSTR(str))

/*
 * 'soft' serial port for GPS
 */
ISR(TIMER0_COMPA_vect)
{
	u08_t	i;

	/* transmit bit interrupt */
	if (gl.gps.txm == 0) {
		if (GPS_TXO_VAL()) { /* was stop bit or pause */
			if (gl.gps.txr != gl.gps.txw) {
				gl.gps.txd = gl.gps.txb[i = gl.gps.txr];
				gl.gps.txr = ++i >= NEL(gl.gps.txb) ? 0 : i;
				GPS_TXO_CLR();	/* send start bit */
			}
			else {
				TIMSK0 &= ~_BV(OCIE0A);	/* compa interrupt OFF */
				gl.gps.txe = 1;
			}
		}
		else { /* was start bit */
			gl.gps.txm = 1;
			if (gl.gps.txd & 01) GPS_TXO_SET();
		}
	}
	else {
		gl.gps.txe = 0;
		gl.gps.txm <<= 1;
		if (gl.gps.txm == 0 || (gl.gps.txd & gl.gps.txm))
			GPS_TXO_SET();
		else	GPS_TXO_CLR();
	}
}

ISR(TIMER0_COMPB_vect)
{
	u08_t	i;

	/* receive bit interrupt */
	i = GPS_RXI_INPUT();
	if (gl.gps.rxm == 0xff) { /* start bit */
		if (i == 0) {
			gl.gps.rxd = 0;
			gl.gps.rxm = 1;
		}
	}
	else {
		if (i) gl.gps.rxd |= gl.gps.rxm;
		if (gl.gps.rxm) gl.gps.rxm <<= 1;	/* more bits to sample */
		else {					/* just sampled stop bit */
			TIMSK0 &= ~_BV(OCIE0B);		/* compb interrupt OFF */
			if (i) {			/* stop bit is valid */
				gl.gps.rxb[i = gl.gps.rxw] = gl.gps.rxd;
				if (++i >= NEL(gl.gps.rxb)) i = 0;
				if (i != gl.gps.rxr) gl.gps.rxw = i;
				gl.gps.rxi |= GPS_RXI;
			}
			GPS_RXI_IRQON();
			gl.gps.lstp = TCNT1;
		}
	}
}

ISR(GPS_RXI_VECT)
{
	u08_t	rxi, tmp;

	rxi = GPS_RXI_INPUT();		/* sample input */
	tmp = rxi ^ gl.gps.rxi;		/* compare to last sample */
	gl.gps.rxi = rxi;		/* save input */
	if (gl.gps.tcnt == 0) {		/* sample timer for figuring out baudrate */
		if (gl.gps.rxw < NEL(gl.gps.rxt)) {
			itic((u16_t *)&gl.gps.rxt[gl.gps.rxw]);
			gl.gps.rxw++;
		}
	}
	else if (tmp && rxi == 0) {	/* it changed and is 0 now -> received start bit */
		tmp = TCNT0;
		tmp += gl.gps.thbt;
		if (tmp == gl.gps.tcnt) tmp++;
		if (tmp > gl.gps.tcnt) tmp -= gl.gps.tcnt;
		if (tmp < 1) tmp++;
		OCR0B = tmp;		/* set sampling point */
		TIFR0  |= _BV(OCF0B);	/* clear in case it is set */
		TIMSK0 |= _BV(OCIE0B);	/* compB interrupt ON */
		GPS_RXI_IRQOF();
		gl.gps.rxm = 0xff;	/* tell timer irq COMPB, next sample is start bit */
	}
}

void gps_sc(char c) /* send character */
{
	u08_t	i;

	gl.gps.txb[i = gl.gps.txw] = c;
	if (++i >= NEL(gl.gps.txb)) i = 0;
	if (i == gl.gps.txr) return;
	gl.gps.txw = i;
	if (TIMSK0 & _BV(OCIE0A)) return;
	TIFR0  |= _BV(OCF0A);		/* clear compa flag */
	TIMSK0 |= _BV(OCIE0A);		/* compa interrupt ON */
}

void gps_snx(u08_t n) { if ((n &= 0x0f) <= 9) gps_sc('0'+n); else gps_sc('A'-10+n); }

void nmea_snd(const char *p)
{
	u08_t	b, cks;

	gps_sc('$');
	for (cks = 0; (b = pgm_read_byte(p)); p++) cks ^= b, gps_sc(b);
	gps_sc('*');
	gps_snx(cks>>4); gps_snx(cks>>0);
	gps_sc('\r'); gps_sc('\n');
}

#define	NMEA_SND(str)	nmea_snd(PSTR(str))

void gps_bdt(void)
{
	int	b;
	u08_t	i;

	/* figure out baudrate from single bit timing, 4800...57600 is MAX! */
	if (gl.gps.rxw == NEL(gl.gps.rxt)) {
		b = 1000;
		for (i = NEL(gl.gps.rxt); --i > 5; ) { /* ignore first couple of samples */
			gl.gps.rxt[i] -= gl.gps.rxt[i-1];
			if (gl.gps.rxt[i] < b) b = gl.gps.rxt[i];
		}
		     if (b >= (int)MS2TIC(0.016) && b <= (int)MS2TIC(0.018)) b = 576;
		else if (b >= (int)MS2TIC(0.025) && b <= (int)MS2TIC(0.027)) b = 384;
		else if (b >= (int)MS2TIC(0.051) && b <= (int)MS2TIC(0.053)) b = 192;
		else if (b >= (int)MS2TIC(0.103) && b <= (int)MS2TIC(0.106)) b =  96;
		else if (b >= (int)MS2TIC(0.205) && b <= (int)MS2TIC(0.210)) b =  48;
		else b = 0;
		tmr0_setup(b);
		gl.gps.cst = 0;
		gl.gps.b_r = gl.gps.b_w = 0;
	}
}

void gps_rcv(void)
{
	u08_t	c, i;

	if (gl.gps.tcnt == 0) {
		gps_bdt();
		return;
	}
	while (1) {
		if (CB_NO_D(gl.gps.rxr,gl.gps.rxw)) break;
		c = (int)gl.gps.rxb[i = gl.gps.rxr];
		gl.gps.rxr = ++i >= NEL(gl.gps.rxb) ? 0 : i;
		/* NMEA: $..........*hh\r\n */
		switch (gl.gps.cst) {
		default:
GPSDROP0:		gl.gps.ech = c;
			gl.gps.est = gl.gps.est ? 0x20 : 0x00;
			gl.gps.est |= gl.gps.cst;
			if (i == gl.gps.b_r) gl.gps.est |= 0x10; /* overflow */
GPSDROP1:		gl.gps.cst = 0;
			break;
		case 6: /* stays here until next '$' arrives */
		case 0: if (c != '$') break;
			gl.gps.cks = 0;
			i = gl.gps.b_s = gl.gps.b_w;
			gl.gps.buf[i] = c;
			if (++i >= NEL(gl.gps.buf)) i = 0;
			if (i == gl.gps.b_r) goto GPSDROP0;
			gl.gps.b_n = 1;
			gl.gps.b_s = i;
			gl.gps.cst = 1;
			break;
		case 1:
			gl.gps.buf[i = gl.gps.b_s] = c;
			if (++i >= NEL(gl.gps.buf)) i = 0;
			if (c < ' ' || c > '~' || i == gl.gps.b_r) goto GPSDROP0;
			if (gl.gps.b_n == 1 && c != 'G') goto GPSDROP1;
			if (gl.gps.b_n == 2 && c != 'P' && c != 'N') goto GPSDROP1;
			gl.gps.b_n++;
			gl.gps.b_s = i;
			if (c == '*') gl.gps.cst = 2;
			else gl.gps.cks ^= c;
			break;
		case 2: case 3:
			gl.gps.buf[i = gl.gps.b_s] = c;
			if (++i >= NEL(gl.gps.buf)) i = 0;
			     if (c >= '0' && c <= '9') c -= '0';
			else if (c >= 'A' && c <= 'F') c -= 'A'-10;
			if (c > 0x0f || i == gl.gps.b_r) goto GPSDROP0;
			gl.gps.b_n++;
			gl.gps.b_s = i;
			gl.gps.cst++;
			if (gl.gps.cst == 3) gl.gps.cks ^= c << 4;
			else if (gl.gps.cks != c) goto GPSDROP0;
			break;
		case 4:
			gl.gps.buf[i = gl.gps.b_s] = c;
			if (++i >= NEL(gl.gps.buf)) i = 0;
			if (c != '\r' || i == gl.gps.b_r) goto GPSDROP0;
			gl.gps.b_n++;
			gl.gps.b_s = i;
			gl.gps.cst = 5;
			break;
		case 5: if (c == '\n' && gl.gps.seq >= 10) gl.gps.b_w = gl.gps.b_s;
			gl.gps.cst = 6;
			break;
		}
	}
	if (gl.gps.cst !=  6) return;	/* message incomplete */
	if (gl.gps.seq >= 10) return;	/* setup done, good to go */
	gl.gps.b_r = gl.gps.b_w = 0;	/* kill received messages during setup */
	if (gl.gps.txr != gl.gps.txw || gl.gps.txe == 0) return; /* not done sending last cmd */
	if ((TCNT1 - gl.gps.lstp) < (u16_t)MS2TIC(10.0)) return; /* wait for gap in data stream */
	switch (gl.gps.seq) {
	case 0: /* check/set baudrate */
		if (gl.gps.b100 == 384)         gl.gps.seq = 2;
		else NMEA_SND("PMTK251,38400"), gl.gps.seq = 1;
		break;
	case 1: tmr0_setup(0);
		gl.gps.seq = 2;
		break;
	/* get RMC,GGA sentences only */
	case 2: NMEA_SND("PMTK314,0,5,0,1,0,0,0,0"); gl.gps.seq = 3; break;
	/* set rate to 200ms, 5Hz */
	case 3: NMEA_SND("PMTK220,200");             gl.gps.seq = 4; break;
	/* done */
	case 4: gl.gps.seq = 10; break;
	}
}

/*
 * RC receiver
 */
#define	PTMAX	MS2TIC(2.05)	/* pulse should be shorter than that */
#define	PTMIN	MS2TIC(0.95)	/* pulse should be longer than that */
#define	PTREF	MS2TIC(1.50)	/* nominal center position */
#define	PTRNG	MS2TIC(0.40)	/* +- nominal spread */

#define	FTMIN	MS2TIC( 8.0)	/* min frametime */
#define	FTMAX	MS2TIC(35.0)	/* max frametime */
#define	FTTOT	MS2TIC(250.0)	/* max frame time out */

ISR(RXSIG_VECT) /* RX signal change interrupt */
{
	union { rsm_t *r; u08_t *b; } p;
	u08_t	i;

	p.r = gl.rxs.rsb;
	i = gl.rxs.rsw;
	p.b += i * sizeof(*p.r);
	p.r->smp = RXSIG;
	itic((u16_t *)&p.r->tmr);
	if (++i >= NEL(gl.rxs.rsb)) i = 0;
	if (i != gl.rxs.rsr) gl.rxs.rsw = i;
#if	RX_CON == 3
#if	0
	static u08_t	fst;
	static u32_t	ltd;
	/* hardware DEBUG, serial RX, frame start is the first down transition after a pause */
	if ((i = (p.r->smp & RXMSK) ? 1 : 0) == 0 && fst) {
		if ((p.r->tmr - ltd) > MS2TIC(3.00)) VLBTG(); /* use VLBA output as scope trigger signal */
		ltd = p.r->tmr;
	}
	fst = i;
#endif
#endif
}

void rx_proc(void)
{
	u32_t	tmr, dtm;
	u08_t	k, i, smp, chg, lsm;

	smp = SREG; cli(); i = gl.rxs.rsw; SREG = smp;
	k = CB_FILL(gl.rxs.rsr,i,NEL(gl.rxs.rsb));
	lsm = gl.rxs.smp;
	while (k) {
		k--;
		i = gl.rxs.rsr;
		smp = gl.rxs.rsb[i].smp;
		tmr = gl.rxs.rsb[i].tmr;
		gl.rxs.rsr = ++i >= NEL(gl.rxs.rsb) ? 0 : i;
		chg = (smp ^ lsm);
		lsm = smp;
#if	RX_CON == 3
		if ((chg & RXMSK) && (smp & RXMSK) == 0) { /* down transition on PPM input */
			dtm = tmr - gl.rxs.srx.ptd;
			gl.rxs.srx.ptd = tmr;
			if (dtm > MS2TIC(3.00)) { /* frame start */
				gl.rxs.srx.idx = 0;
				gl.rxs.ftm = tmr - gl.rxs.lfs;
				gl.rxs.lfs = tmr;
			}
			else if ((i = gl.rxs.srx.idx) < NEL(gl.rxs.chn)) {
				gl.rxs.chn[i].tac = tmr;
				gl.rxs.chn[i].dur = dtm;
				gl.rxs.srx.idx++;
			}
		}
#else
		for (i = 0; (chg & RXMSK) && i < NEL(gl.rxs.chn); i++)
			if (chg & gl.rxs.chn[i].msk) {
				dtm = tmr - gl.rxs.chn[i].tac;
				if (smp & gl.rxs.chn[i].msk) {
					gl.rxs.chn[i].tac = tmr;
					if (i == S_AILE) { /* AILE is usually the first pulse */
						gl.rxs.ftm = tmr - gl.rxs.lfs;
						gl.rxs.lfs = tmr;
					}
				}
				else gl.rxs.chn[i].dur = dtm;
				chg &= ~gl.rxs.chn[i].msk;
			}
#endif
	}
	gl.rxs.smp = lsm;
}

int rx_tk2v(int dur, int dbn)
{
	int	val;

	dur -= PTREF;
	if (dur >= 0) { if ((dur -= dbn) <= 0) return 0; }
	else          { if ((dur += dbn) >= 0) return 0; }
	val = (int)((long)(dur * 1000L + PTRNG/2)/(long)(PTRNG - dbn));
	val = val < -1000 ? -1000 : val > 1000 ? 1000 : val;
	return val;
}

u08_t rx_esel(int thr)
{
	int	v, h;
	u08_t	isp;

	isp = 0;
	if ((v = gl.rxs.chn[ S_ELEV].val) < 0) v *= -1; else isp |= 01;
	if ((h = gl.rxs.chn[SH_ELEV].val) < 0) h *= -1; else isp |= 02;
	if (v < thr && h < thr) return 0;
	return v >= h ? (isp & 01) ? 1 : 3 : (isp & 02) ? 4 : 2;
}

u08_t rx_read(void)
{
	u08_t	err, mch;
	u32_t	tot;
	int	val;
	struct chn *c;

	if (CB_HASD(gl.rxs.rsr,gl.rxs.rsw)) rx_proc();
	err = 0;
	tot = tic();
	if (gl.rxs.ftm < FTMIN || gl.rxs.ftm > FTMAX) err = S_SIG;
	else {
		mch = _BV(NEL(gl.rxs.chn)-1);
		for (c = gl.rxs.chn + NEL(gl.rxs.chn); --c >= gl.rxs.chn; mch >>= 1)
			if (!(mch & S_SIG)) continue;	/* bit/channel is not used */
			else if ((tot - c->tac) > FTTOT) err |= mch;
			else if (c->dur < PTMIN || c->dur > PTMAX) err |= mch;
			else c->val = rx_tk2v(c->dur,c->dbn);
	}

	if ((gl.rxs.err = err)) { /* there is a problem with one or more RX signals */
		if (gl.rxs.erx < S2LTIC(0.5)) {
			/* delay error reporting */
			gl.rxs.erx++;
			return 0;
		}
		if (err == S_SIG) gl.rxs.ftm = 0;
		for (c = gl.rxs.chn + NEL(gl.rxs.chn); --c >= gl.rxs.chn; ) c->val = 0;
		return err;
	}
	/* all RX signals ok */
	gl.rxs.erx = 0;

	if (1) gl.rxs.chn[S_AUX1].val *= -1;	/* legacy, can be done in TX */

	val = gl.rxs.chn[S_LAND].val;
	switch (S_LAND) {
	case S_GEAR: gl.rxs.fms =       val < 0 ? FMS_LAND : FMS_FM_1; break;
	case S_AUX1: gl.rxs.fms = val ? val < 0 ? FMS_LAND : FMS_FM_2 : FMS_FM_1; break;
	}
	if (S_FMOD != S_LAND && gl.rxs.fms != FMS_LAND) /* 2 switches and in the air */
		gl.rxs.fms = gl.rxs.chn[S_FMOD].val < 0 ? FMS_FM_1 : FMS_FM_2;

	/* extended flightmode sequencer */
	switch (gl.rxs.fsq) {
	default: gl.rxs.fsq = 0; break;
	case 0: if (gl.rxs.fms == FMS_FM_2) gl.rxs.fsq = 1; break;
	case 1: if (gl.rxs.fms == FMS_LAND) gl.rxs.fsq = 0;
		else if (gl.rxs.fms == FMS_FM_1) {
			/* switch to FM_1, arms trigger mechanism */
			gl.rxs.fst = S2LTIC(0.5);
			gl.rxs.fsq = 2;
			gl.rxs.fms = FMS_FM_2;
		}
		break;
	case 2: gl.rxs.fsq = 0;
		if ((gl.rxs.fst -= 1) == 0) break; /* timeout */
		if (gl.rxs.fms == FMS_LAND) break; /* land */
		if (gl.rxs.fms == FMS_FM_1) {
			/* keep FM_2 during timeout period */
			gl.rxs.fsq = 2;
			gl.rxs.fms = FMS_FM_2;
			break;
		}
		if (gl.rxs.fms != FMS_FM_2) break;
		/* user switched back to FM_2 before timeout */
		gl.rxs.fst = S2LTIC(0.40);	/* animation trigger window */
		gl.rxs.fsq = 3;
		break;
	case 3: if (gl.rxs.fms != FMS_FM_2) { /* switch changed */
			gl.rxs.fsq = 0;
			break;
		}
		if ((gl.rxs.fst -= 1) == 0) { /* enter FM_3 */
			gl.rxs.fms = FMS_FM_3;
			gl.rxs.fsq = 5;
			break;
		}
		if ((mch = rx_esel(100)) == 0) break;
		/* trigger animation */
		gl.rxs.fst = S2LTIC(0.5);
		gl.rxs.fsa = mch;
		gl.rxs.fsq = 4;
		break;
	case 4: if ((gl.rxs.fst -= 1) == 0 || gl.rxs.fsa == 0)
			gl.rxs.fsq = gl.rxs.fsa = 0;
		break;
	case 5: gl.rxs.fsq = 0;
		if (gl.rxs.fms != FMS_FM_2) break;	/* switch changed */
		if (rx_esel(150)) break;		/* stick moved */
		gl.rxs.fsq = 5;
		gl.rxs.fms = FMS_FM_3;
		break;
	}

#if	GSWO_ENA >= 0 && GSWO_SRC == 0
	if (gl.rxs.chn[S_GEAR].val <= 0) GSWOF(); else GSWON();
#endif

	if (gl.rxs.fms == FMS_LAND) {
		mch = 0;
		val = gl.rxs.chn[ S_THRO].val; if (ABS(val) > STKTHR) mch |= val < 0 ? TS_DN : TS_UP;
		val = gl.rxs.chn[SH_THRO].val; if (ABS(val) > STKTHR) mch |= val < 0 ? TS_LF : TS_RT;
		val = gl.rxs.chn[ S_ELEV].val; if (ABS(val) > STKTHR) mch |= val < 0 ? ES_UP : ES_DN;
		val = gl.rxs.chn[SH_ELEV].val; if (ABS(val) > STKTHR) mch |= val < 0 ? ES_LF : ES_RT;
		gl.rxs.stk = mch;
		/* alternate configuration selection */
		if ((gl.rxs.stk & TS_MSK) == TS_UP)
			gl.cfw = (char)rx_esel(STKTHR) - 1;
		else {
			if (gl.cfw >= 0 && gl.cfg != gl.cfw && gl.eewen >= NEL(gl.eedat)) {
				gl.cfg = gl.cfw;
				eepr_save();
			}
			gl.cfw = -1;
		}
#if	GSWO_ENA >= 0 && GSWO_SRC == 1
		if ((gl.rxs.stk & TS_MSK) == (TS_UP|TS_LF) && gl.beep.nbp == 0) gl.beep.nbp = 5;
#endif
	}
	else {
		gl.rxs.stk = 0;
		gl.cfw = -1;
	}
	return 0;
}

/*
 * messages from drone
 */
#define	C_ACK	0x01
void sio_rcv(void)
{
	int	r;
	char	c;

	while ((r = sio_rc()) >= 0)
		if ((c = r) <= 0) gl.drm.cst = 0;
		else if (c == C_ACK) gl.drm.ack = 1, gl.drm.cst = 0;
		else switch (gl.drm.cst) {
		case 0: if (c == '$') gl.drm.cst = 1, gl.drm.nda = 0; break;
		case 1: if (c == '*') {
				if (gl.drm.nda == sizeof(gl.drm.dat.m2a)) {
#if GSWO_ENA >= 0 && GSWO_SRC == 1
					if (gl.drm.dat.m2a.beep > 0 && gl.beep.nbp == 0)
						gl.beep.nbp = gl.drm.dat.m2a.beep;
#endif
					gl.drm.m2a = gl.drm.dat.m2a;
				}
				gl.drm.cst = 0;
				break;
			}
			/* FALLTHROUGH */
		case 2: if (c >= '0' && c <= '9') c -= '0';
			else if (c >= 'A' && c <= 'F') c -= 'A'-10;
			else if (c >= 'a' && c <= 'f') c -= 'a'-10;
			else c = -1;
			if (c < 0 || gl.drm.nda >= sizeof(gl.drm.dat)) {
				gl.drm.cst = 0;
				break;
			}
			if (gl.drm.cst == 1)
				gl.drm.dat.b[gl.drm.nda] = (c<<4);
			else	gl.drm.dat.b[gl.drm.nda++] |= c;
			gl.drm.cst ^= 3;
			break;
		}
}

#if	U4
#undef	usb_sq
/*
 * MiruPCB USB interface
 */
typedef struct { /* Standard Device Descriptor */
	u08_t	bLength;
	u08_t	bDescriptorType;
	u16_t	bcdUSB;
	u08_t	bDeviceClass;
	u08_t	bDeviceSubClass;
	u08_t	bDeviceProtocol;
	u08_t	bMaxPacketSize0;
	u16_t	idVendor;
	u16_t	idProduct;
	u16_t	bcdDevice;
	u08_t	iManufacturer;
	u08_t	iProduct;
	u08_t	iSerialNumber;
	u08_t	bNumConfigurations;
}	usb_sdd_t; /* 18 bytes */

typedef struct { /* Standard Configuration Descriptor */
	u08_t	bLength;
	u08_t	bDescriptorType;
	u16_t	wTotalLength;
	u08_t	bNumInterfaces;
	u08_t	bConfigurationValue;
	u08_t	iConfiguration;
	u08_t	bmAttributes;
	u08_t	bMaxPower;	/* in 2mA units, 50 ^ 100mA */
}	usb_scd_t; /* 9 bytes */

typedef struct { /* Standard Interface Descriptor */
	u08_t	bLength;
	u08_t	bDescriptorType;
	u08_t	bInterfaceNumber;
	u08_t	bAlternateSetting;
	u08_t	bNumEndPoints;
	u08_t	bInterfaceClass;
	u08_t	bInterfaceSubClass;
	u08_t	bInterfaceProtocol;
	u08_t	iInterface;
}	usb_sid_t; /* 9 bytes */

typedef struct { /* Standard Endpoint Descriptor */
	u08_t	bLength;
	u08_t	bDescriptorType;
	u08_t	bEndPointAddress;
	u08_t	bmAttributes;
	u16_t	wMaxPacketSize;
	u08_t	bInterval;
}	usb_sep_t; /* 7 bytes */

#define DSC_DEV	1	// DEVICE
#define DSC_CFG	2	// CONFIGURATION
#define DSC_STR	3	// STRING
#define DSC_IFC	4	// INTERFACE
#define DSC_EPT	5	// ENDPOINT
#define DSC_DQU	6	// DEVICE_QUALIFIER
#define DSC_OSC	7	// OTHER_SPEED_CONFIGURATION
#define DSC_PWR	8	// INTERFACE_POWER

const usb_sdd_t usb_sdd PROGMEM = {
 .bLength = sizeof(usb_sdd_t), .bDescriptorType = DSC_DEV, .bcdUSB = 0x0200,
 .bDeviceClass       = 0,
 .bDeviceSubClass    = 0,
 .bDeviceProtocol    = 0,
 .bMaxPacketSize0    = 64,
 .idVendor           = 0x0403, /* FTDI */
 .idProduct          = 0x6001, /* FT232 USB-Serial (UART) IC */
 .bcdDevice          = 0x0600,
 .iManufacturer      = 0,
 .iProduct           = 0,
 .iSerialNumber      = 0,
 .bNumConfigurations = 1,
};

#define	EP1_LGS		3	/* endpoint size (0 == 8, 1 == 16, 2 == 32 ... 6 == 512) */
#define	EP2_LGS		3	/* endpoint size (0 == 8, 1 == 16, 2 == 32 ... 6 == 512) */
const struct {
	usb_scd_t	scd;	/* 9 bytes */
	usb_sid_t	sid;	/* 9 bytes */
	usb_sep_t	ept[2];	/* 7 bytes each */
}	usb_cfg PROGMEM = {
 .scd.bLength = sizeof(usb_scd_t), .scd.bDescriptorType = DSC_CFG,
 .scd.wTotalLength        = sizeof(usb_scd_t) + sizeof(usb_sid_t) + 2*sizeof(usb_sep_t),
 .scd.bNumInterfaces      = 1,
 .scd.bConfigurationValue = 1,
 .scd.iConfiguration      = 0,
 .scd.bmAttributes        = 0xa0,
 .scd.bMaxPower           = 100/2,

 .sid.bLength = sizeof(usb_sid_t), .sid.bDescriptorType = DSC_IFC,
 .sid.bInterfaceNumber    = 0,
 .sid.bAlternateSetting   = 0,
 .sid.bNumEndPoints       = 2,
 .sid.bInterfaceClass     = 0xff, /* vendor specific */
 .sid.bInterfaceSubClass  = 0xff,
 .sid.bInterfaceProtocol  = 0xff,
 .sid.iInterface          = 2,

 .ept[0].bLength = sizeof(usb_sep_t), .ept[0].bDescriptorType = DSC_EPT,
 .ept[0].bEndPointAddress = 0x81, /* EP 1 IN dev->host */
 .ept[0].bmAttributes     = 0x02, /* BULK */
 .ept[0].wMaxPacketSize   = (8<<EP1_LGS),
 .ept[0].bInterval        = 0,

 .ept[1].bLength = sizeof(usb_sep_t), .ept[1].bDescriptorType = DSC_EPT,
 .ept[1].bEndPointAddress = 0x02, /* EP 2 OUT dev<-host */
 .ept[1].bmAttributes     = 0x02, /* BULK */
 .ept[1].wMaxPacketSize   = (8<<EP2_LGS),
 .ept[1].bInterval        = 0,
};

u08_t usb_tf(void) /* txb free space */
{
	return CB_FREE(gl.usb.ep1r,gl.usb.ep1w,NEL(gl.usb.ep1b));
}

void usb_sc(char c)
{
	u08_t	i;

	gl.usb.ep1b[i = gl.usb.ep1w] = c;
	if (++i >= NEL(gl.usb.ep1b)) i = 0;
	if (i != gl.usb.ep1r) gl.usb.ep1w = i;
}

void usb_sp(const char *p) /* send string from flash */
{
	char	c;

	while ((c = pgm_read_byte(p++))) usb_sc(c);
}

#define	USB_SP(str)	usb_sp(PSTR(str))

int usb_rc(void) /* read next character received */
{
	int	b;

	if (gl.usb.ep2r == 0) return -1;
	UENUM = 2;
	if (!(UEINTX & _BV(FIFOCON))) return -1;
	b = UEDATX;
	if (--gl.usb.ep2r == 0) UEINTX &= ~_BV(FIFOCON);
	return b;
}

ISR(USB_GEN_vect)
{
	u08_t	irq, ept;

	irq = UDINT;
	ept = UENUM;
	UDINT = 0b00000000;	/* -,uprsmi,eorsmi,wakeup,eorsti,sofi,-,suspi */
	irq &= UDIEN;
	if (irq & _BV(EORSTI)) {
		gl.usb.ep0a = 0;
		gl.usb.ep0r = 0;
		gl.usb.ep1w = 0;
		gl.usb.ep1r = 0;
		gl.usb.sofi = 0;
		gl.usb.ep1h = 1;
		gl.usb.mdst = RST_MDST;
		gl.usb.lnst = RST_LNST;
		UENUM   = 0;
		UECONX  = 0b00000001;	/* -,-,stallrq,stallqc,rstdt,-,-,EPEN */
		UECFG0X = 0b00000000;	/* ept1,ept0,-,-,-,-,-,epdir */
		UECFG1X = 0b00110010;	/* -,eps2,EPS1,EPS0,epbk1,epbk0,ALLOC,- 64 bytes */
		if (UESTA0X & _BV(CFGOK)) {
			UEIENX = _BV(RXSTPE);	/* enable IRQs for EP 0 */
			gl.usb.ep0a = 1;	/* enable usb_sq */
		}
	}
	if (irq & _BV(SOFI)) gl.usb.sofi++;
	UENUM = ept;
}

ISR(USB_COM_vect)
{
	u08_t	ept = UENUM;

	/* UEINTX: fifocon,nakini,rwal,nakouti,rxstpi,rxouti,stalledi,txini */
	if (UEINT & 01) { /* control endpoint */
		UENUM = 0;
		if ((UEINTX & _BV(RXSTPI))) {
			if (gl.usb.ep0r == 0)
				while (gl.usb.ep0r < 8) gl.usb.ep0b.b[gl.usb.ep0r++] = UEDATX;
			UEINTX = 0;
		}
	}
	if (UEINT & 02) { /* IN endpoint dev->host, outgoing data */
		UENUM = 1;
		if ((UEINTX & _BV(TXINI))) {
			gl.usb.ep1h = 0;
			UEINTX &= ~_BV(TXINI);
		}
	}
	if (UEINT & 04) { /* OUT endpoint dev<-host, incoming data */
		UENUM = 2;
		if ((UEINTX & _BV(RXOUTI))) {
			gl.usb.ep2r += UEBCX;
			UEINTX &= ~_BV(RXOUTI);
		}
	}
	UENUM = ept;
}

void usbd_psnd(const void *buf, u08_t nbu)
{
	const u08_t	*d = buf;
	u08_t		n;

	for (n = 0; n < nbu; n++) {
		while (!(UEINTX & (_BV(TXINI)|_BV(RXOUTI))));
		if (UEINTX & _BV(RXOUTI)) break;
		UEDATX = pgm_read_byte(d++);
	}
}

void usb_sq(void)
{
	u08_t	i;

	if (gl.usb.ep0a == 0) return;
	/*
	 * EP1, IN endpoint dev->host
	 */
	if (gl.usb.ep1h == 0 && (CB_HASD(gl.usb.ep1r,gl.usb.ep1w) || gl.usb.sofi >= 40)) {
		UENUM = 1;
		UEDATX = MDST(gl.usb.mdst);
		UEDATX = RUN_LNST;
		while ((UEINTX & _BV(RWAL))) {
			if (CB_NO_D(gl.usb.ep1r,gl.usb.ep1w)) break;
			UEDATX = gl.usb.ep1b[i = gl.usb.ep1r];
			gl.usb.ep1r = ++i >= NEL(gl.usb.ep1b) ? 0 : i;
		}
		gl.usb.sofi = 0;
		gl.usb.ep1h = 1;
		UEINTX &= ~_BV(FIFOCON);
	}
	/*
	 * control endpoint
	 */
	if (gl.usb.ep0r == 0) return;
	i = SREG; cli();
	UENUM = 0;
	if (gl.usb.ep0b.bmRequestType & REQ_D2H)
		while (!(UEINTX & _BV(TXINI)));
	else	UEINTX = ~_BV(TXINI);
	switch ((gl.usb.ep0b.bmRequestType & REQ_TYP)) {
	case REQ_STD:
		switch (gl.usb.ep0b.bRequest) {
		case GET_STATUS:
			UEDATX = 0;
			UEDATX = 0;
			UEINTX &= ~_BV(TXINI);
			break;
		case SET_ADR:
			while (!(UEINTX & _BV(TXINI)));
			UDADDR = gl.usb.ep0b.wValue;
			UEINTX &= ~_BV(TXINI);
			UDADDR |= _BV(ADDEN);
			break;
		case GET_DSC:
			switch (gl.usb.ep0b.wValue>>8) {
			case DSC_DEV: /* 1 USB_DEVICE_DESCRIPTOR_TYPE */
				usbd_psnd(&usb_sdd,MIN(gl.usb.ep0b.wLength,sizeof(usb_sdd)));
				UEINTX &= ~_BV(TXINI);
				break;
			case DSC_CFG: /* 2 USB_CONFIGURATION_DESCRIPTOR_TYPE */
				usbd_psnd(&usb_cfg,MIN(gl.usb.ep0b.wLength,sizeof(usb_cfg)));
				UEINTX &= ~_BV(TXINI);
				break;
#if	0
			case DSC_STR: /* 3 USB_STRING_DESCRIPTOR_TYPE */
			case DSC_IFC: /* 4 USB_INTERFACE_DESCRIPTOR_TYPE */
			case DSC_EPT: /* 5 USB_ENDPOINT_DESCRIPTOR_TYPE */
			case DSC_DQU: /* 6 USB_DEVICE_QUALIFIER_TYPE */
			case DSC_OSC: /* 7 USB_OTHER_SPEED_CONFIGURATION_TYPE */
			case DSC_PWR: /* 8 USB_INTERFACE_POWER_TYPE */
#endif
			default: UECONX |= _BV(STALLRQ); break;
			}
			break;
		case GET_CFG:
			UEDATX = 1;
			UEINTX &= ~_BV(TXINI);
			break;
		case SET_CFG:
			switch ((gl.usb.ep0b.bmRequestType & REQ_DST)) {
			case REQ_DEV:
				UENUM   = 1;	/* IN DEV -> HOST */
				UECONX  = 1;
				UECFG0X = 0b10000001; /* ept[1:0],-,-,-,-,-,EPDIR  BULK IN */
				UECFG1X = (EP1_LGS<<4)|0b0110; /* -,epsize[2:0]=010,epbk[1:0]=01,ALLOC,- double */
				UEIENX  = 0b00000001; /* flerre,nakine,-,nakoute,rxstpe,rxoute,stallede,TXINE */
				UENUM   = 2;	/* OUT HOST -> DEV */
				UECONX  = 1;
				UECFG0X = 0b10000000; /* ept[1:0],-,-,-,-,-,epdir  BULK OUT */
				UECFG1X = (EP2_LGS<<4)|0b0110; /* -,epsize[2:0]=010,epbk[1:0]=01,ALLOC,- double */
				UEIENX  = 0b00000100; /* flerre,nakine,-,nakoute,rxstpe,RXOUTE,stallede,txine */
				break;
//			case REQ_IFC:
//			case REQ_EPT:
//			default:
//				break;
			}
			break;
		default: UECONX |= _BV(STALLRQ); break;
		}
		break;
	case REQ_VEN:
		switch (gl.usb.ep0b.bRequest) {
		case  0: /* FTDI_SIO_RESET		 0 reset port */
			gl.usb.mdst = RST_MDST;
			gl.usb.lnst = RST_LNST;
			gl.usb.tlat = 0;
			UEINTX &= ~_BV(TXINI);
			break;
		case  1: /* FTDI_SIO_MODEM_CTRL		 1 set modem control register */
#if	0
			if (gl.usb.ep0b.wValue & 0x0200) {
				if (gl.usb.ep0b.wValue & 0x02)
					gl.usb.mdst |=  MDST_RTS;
				else	gl.usb.mdst &= ~MDST_RTS;
			}
#endif
			if (gl.usb.ep0b.wValue & 0x0100) {
				while (1) {
					/* raising DTR at 1200 baud, 8 bits means RESET */
					if (!(gl.usb.mdst & MDST_DTR)) break;
					if (gl.usb.ep0b.wValue & 0x01) break;
					if (gl.usb.baud != 0x09c4) break; /* 0x09c4 is 1200 baud */
					if (gl.usb.sfmt != 0x0008) break; /* should be on 8 bits/char */
					gl.exit = 1;
					break;
				}
				if (gl.usb.ep0b.wValue & 0x01)
					gl.usb.mdst |=  MDST_DTR;
				else	gl.usb.mdst &= ~MDST_DTR;
			}
			UEINTX &= ~_BV(TXINI);
			break;
		case  3: /* FTDI_SIO_SET_BAUD_RATE	 3 set baud rate */
			gl.usb.baud = gl.usb.ep0b.wValue;
			UEINTX &= ~_BV(TXINI);
			break;
		case  4: /* FTDI_SIO_SET_DATA		 4 set data format */
			gl.usb.sfmt = gl.usb.ep0b.wValue;
			UEINTX &= ~_BV(TXINI);
			break;
		case  5: /* FTDI_SIO_GET_MODEM_STATUS	 5 get modem status register */
			if (gl.usb.ep0b.wLength > 0) UEDATX = MDST(gl.usb.mdst);
			if (gl.usb.ep0b.wLength > 1) UEDATX = RUN_LNST;
			/* FALLTHROUGH */
		case  2: /* FTDI_SIO_SET_FLOW_CTRL	 2 set flow control register */
		case  6: /* FTDI_SIO_SET_EVENT_CHAR	 6 set event character */
		case  7: /* FTDI_SIO_SET_ERROR_CHAR	 7 set error character */
			UEINTX &= ~_BV(TXINI);
			break;
		case  9: /* FTDI_SIO_SET_LATENCY_TIMER	 9 set latency timer */
			gl.usb.tlat = gl.usb.ep0b.wValue;
			UEINTX &= ~_BV(TXINI);
			break;
		case 10: /* FTDI_SIO_GET_LATENCY_TIMER	10 get latency timer */
			if (gl.usb.ep0b.wLength > 0) UEDATX = (gl.usb.tlat>>0);
			if (gl.usb.ep0b.wLength > 1) UEDATX = (gl.usb.tlat>>8);
			UEINTX &= ~_BV(TXINI);
			break;
		default: UECONX |= _BV(STALLRQ); break;
		}
		break;
	default:
		UECONX |= _BV(STALLRQ);
		break;
	}
	gl.usb.ep0r = 0;
	SREG = i;
}

void usb_tw(void) /* wait for tx empty */
{
	do usb_sq(); while (gl.usb.sofi < 100 && CB_HASD(gl.usb.ep1r,gl.usb.ep1w));
}

void usb_init(void)
{
	u08_t	sreg;

	sreg = SREG; cli();
	USBCON = 0b00000000;	/* usbe,-,frzclk,otgpade,-,-,-,vbuste */
	UHWCON = 0b00000001;	/* -,-,-,-,-,-,-,UVREGE */
	USBCON = 0b10100000;	/* USBE,-,FRZCLK,otgpade,-,-,-,vbuste */
	PLLCSR = 0b00010010;	/* -,-,-,PINDIV,-,-,PLLE,plock */
	while (!(PLLCSR & _BV(PLOCK)));
	UDINT  = 0b00000000;	/* -,uprsme,eorsme,wakeupe,eorste,sofe,-,suspe */
	USBCON = 0b10010000;	/* USBE,-,frzclk,OTGPADE,-,-,-,vbuste */
	UDIEN  = 0b00001100;	/* -,uprsme,eorsme,wakeupe,EORSTE,SOFE,-,suspe */
	UDCON  = 0b00000000;	/* -,-,-,-,rstcpu,lsm,rmwkup,detach */
	SREG = sreg;
}
#endif

#if	AT2SO == 1
/*
 * drone companion program piggy back in flash
 */
void at2so_chck(void)
{
	u16_t	adr, mag, siz, cks;
	extern const u08_t at2so_buf[];

	adr = (u16_t)at2so_buf;
	mag = pgm_read_word(adr); adr += 2;
	siz = pgm_read_word(adr); adr += 2;
	cks = pgm_read_word(adr); adr += 2;
	if (mag != 0x55aa) return;
	if (siz < ( 1*1024)) return;
	if (siz > (20*1024)) return;
	gl.arm.adr = adr;
	gl.arm.siz = siz;
	gl.arm.cks = cks;
}

int at2so_load(void)
{
	union { u16_t w; u08_t b[2]; } v;
	u16_t	cks, adr;
	int	n;

	/* put tty we are talking to into raw mode, will be
	 * sending binary data -> NO interpretation please! */
	SIO_SP("stty -echo -iexten pass8 raw\n");
	ms_dly(50); sio_rf();
	/* 'dd' is the program of choice to receive the data, need to
	 * tell it how much is coming, so it quits after the transfer.
	 * 'dd' on drone is the 'amputated' version without bells and
	 * whistles. */
	SIO_SP("dd of=/tmp/$F.gz bs=1 count=");
	snd_sid(0,gl.arm.siz);
	sio_sc('\n');
	ms_dly(100); sio_rf();
	for (adr = gl.arm.adr, n = cks = 0;;) {
		v.w = pgm_read_word(adr+n); /* reads 2 bytes from flash */
		sio_sc(v.b[0]); cks += v.b[0];
		if (++n >= gl.arm.siz) break;
		sio_sc(v.b[1]); cks += v.b[1];
		if (++n >= gl.arm.siz) break;
		if ((n & 0x1f) == 0) {
			LEDTG(); /* makes LED look like it is dimmed */
			while (CB_HASD(gl.sio.txr,gl.sio.txw));
			ms_dly(1);
		}
	}
	ms_dly(50); sio_rf();
	/* put tty back to 'normal' */
	SIO_SP("stty sane\n"); ms_dly(50); sio_rf();
	if (n != gl.arm.siz || cks != gl.arm.cks) return 0; /* upload bad */
	/* unzip it */
	SIO_SP("gunzip /tmp/$F.gz\n"); ms_dly(100); sio_rf();
	ms_dly(50); sio_rf();
	return 1;
}
#endif

#define	C_STRT	0x02
#define	C_STOP	0x04

void at2so_lstp(u08_t n)
{
	while (1) {
		blip(1); ms_dly(1000);
		blip(n); ms_dly(2000);
	}
}

char sio_w4lf(int nms)
{
	int	k;

	for ( ; nms; nms -= 1, ms_dly(1))
		while ((k = sio_rc()) >= 0) if (k == '\n') return 0;
	return -1;
}

char sio_w4ln(int nms, u08_t *lbu, u08_t nlb)
{
	int	k;
	u08_t	i;

	for (i = 0; nms; nms -= 1, ms_dly(1))
		while ((k = sio_rc()) >= 0) {
			if (k == '\n') return (char)i;
			if (i < nlb) lbu[i++] = k;
		}
	return -1;
}

int at2so_txfr(const char *pnm)
{
	u08_t	lbu[4];

	sio_rf(); SIO_SP("F="); sio_sp(pnm); sio_rev(); SIO_SP(".arm\n");
	if (sio_w4lf(99)) return -1; /* communication bad */
	sio_rf(); SIO_SP("if [ -f $D/$F ];then cp $D/$F /tmp;echo 1;else echo 0;fi\n");
	if (sio_w4lf(99)) return -1; /* communication bad */
	return sio_w4ln(99,lbu,NEL(lbu)) < 1 ? -1 : lbu[0] == '1' ? 1 : 0;
}

int ld_comprgr(void)
{
	int	n;

	if ((n = at2so_txfr(PSTR("pilot")))) return n;
	if ((n = at2so_txfr(PSTR("at2so")))) return n;
	return 0;
}

void at2so_exec(u08_t blkwifi)
{
	int	n;

	/* change baudrate since Arduino at 16 Mhz has problems receiving back to
	 * back characters at 115200 with half speed receiver
	 * 76800 would be nice because it can do it, but stty on drone is amputated... */
	if ((SIO_UCSRA & _BV(SIO_U2X))) {
		/* is using double speed on serial transmitter, which is not good for
		 * receiver (half sampling rate) -> change baudrate to 38400 to fix this */
		SIO_SP("stty 38400\n");
		ms_dly(10); sio_rf();
		SIO_UBRR  = (F_CPU/(16UL*38400UL)-1);
		SIO_UCSRA = 0b00000000;	/* rxc0,txc0,udre0,fe0,dor0,upe0,u2x0,mpcm0 */
		ms_dly(50); sio_rf();
		SIO_UCSRB |= _BV(SIO_RXCIE)|_BV(SIO_RXEN)|_BV(SIO_TXEN);
		sio_sc('\r');		/* send a character at new baudrate */
		ms_dly(20); sio_rf();	/* wait a while and clear residuals if any */
	}
	sio_rf(); sio_sc('\n');
	if (sio_w4lf(99)) at2so_lstp(1);	/* communication bad */
	sio_rf(); SIO_SP("D=/data/video/usb\n");
	if (sio_w4lf(99)) at2so_lstp(2);	/* communication bad */
	if ((n = ld_comprgr()) < 0) at2so_lstp(3);
	else if (n == 0) {
		sio_rf(); SIO_SP("D=/data/video\n");
		if (sio_w4lf(99)) at2so_lstp(5);/* communication bad */
		if ((n = ld_comprgr()) < 0) at2so_lstp(6);
	}
#if	AT2SO == 1
	if (n == 0 && gl.arm.adr != 0) n = at2so_load();
#endif
	if (n == 0) at2so_lstp(8);		/* no companion program */

	LEDON();
	/* make companion program executable */
	SIO_SP("chmod +x /tmp/$F\n"); ms_dly(50); sio_rf();
	/* launch compagnion program */
	SIO_SP("/tmp/$F");
	if (blkwifi) SIO_SP(" -w");
	SIO_SP(" -l ");	gl.bid++; snd_sid(0,gl.bid); /* boot id */
	ms_dly(25); sio_rf();	/* wait out echo */
	sio_sc('\n');		/* and launch */

	/* wait for companion program to send start character */
	while (1) {
		if ((n = sio_rc()) < 0) ms_dly(1);
		else if (n == C_STRT) break;
		while (n == C_STOP) at2so_lstp(9); /* there is another controller active */
	}
	eepr_save();	/* store new 'bid' in EEPROM */
}

/*
 * RC receiver interface debug/setup loop
 */
void csisclr(void)  { SND_SP("\033[H\033[0m\033[2J"); }	/* home, clear attributes, clear screen */
void csirclr(void)  { SND_SP("\033[0J"); }
void csilclr(void)  { SND_SP("\033[K"); }
void csirow(int  r) { SND_SP("\033["); snd_sid(0,r); SND_SP(";1H"); }
void csilco(char c) { SND_SP("\033[0;"); snd_sbx(0x30+c); snd_sc('m'); }
void csihco(char c) { SND_SP("\033[1;"); snd_sbx(0x30+c); snd_sc('m'); }

#define	DLN0	1
#define	DLN1	2
#define	DLN2	3
#define	DLN3	4
#define	DLNRXI	6
#define	DLNRXC	7
#define	DLNGGA	14
#define	DLNRMC	15
#define	DLNOTH	16
#define	DLNBMPD	18  /* BMP data */
#define	DLNBMPC	19  /* BMP calibration */
#define	DLNHMCD	20  /* HMC data */
#define	DLNHMCC	21  /* HMC calibration */

#define	BLACK	0
#define	RED	1
#define	GREEN	2
#define	YELLOW	3
#define	BLUE	4
#define	MAGENTA	5
#define	CYAN	6
#define	WHITE	7

void rdcfg(u08_t *buf)
{
	u08_t	srg;

	srg = SREG; cli();
	buf[0] = boot_lock_fuse_bits_get(GET_HIGH_FUSE_BITS);
	buf[1] = boot_lock_fuse_bits_get(GET_LOW_FUSE_BITS);
	buf[2] = boot_lock_fuse_bits_get(GET_EXTENDED_FUSE_BITS);
	buf[3] = boot_lock_fuse_bits_get(GET_LOCK_BITS);
	buf[4] = boot_signature_byte_get(0);
	buf[5] = boot_signature_byte_get(2);
	buf[6] = boot_signature_byte_get(4);
	SREG = srg;
}

void snd_est(void)
{
	SND_SP("$GPERR,");
	snd_sbx(gl.gps.est);
	snd_sc(',');
	snd_sbx(gl.gps.ech);
	gl.gps.est = 0;
}

void su_sgps(void)
{
	char	c;
	int	i;

	if (gl.gps.est) csirow(DLNOTH), csihco(RED), snd_est(), csilclr();
	while (CB_HASD(gl.gps.b_r,gl.gps.b_w) && sio_tf() >= 100) {
		if (++gl.gps.b_r >= NEL(gl.gps.buf)) gl.gps.b_r = 0;
		if ((i = gl.gps.b_r + 2) >= NEL(gl.gps.buf)) i -= NEL(gl.gps.buf);
		c = gl.gps.buf[i];
		if (c == 'G') csirow(DLNGGA), csihco(GREEN);
		else if (c == 'R') csirow(DLNRMC), csihco(GREEN);
		else csirow(DLNOTH), csihco(RED);
		while (1) {
			c = gl.gps.buf[gl.gps.b_r];
			if (++gl.gps.b_r >= NEL(gl.gps.buf)) gl.gps.b_r = 0;
			if (c == '\r') break;
			snd_sc(c);
		}
		csilclr();
	}
}

#define	HZ2TIC(hz)	((double)F_TM1/(double)(hz))
#define	DRUPD		(u32_t)HZ2TIC(LOOPHZ)	/* dr_loop() cycle time in timer 1 ticks */

void su_loop(void)
{
	u08_t	i = 0, k, n, msk;
	char	j;
	int	rxs;
	long	tmp;
	u32_t	nxt;
	u08_t	cfg[7];

#if	U4 == 0
#define	GUI_TW	sio_tw
#define	GUI_RC	sio_rc
#define	GUI_TF	sio_tf
#else
#define	GUI_TW	usb_tw
#define	GUI_RC	usb_rc
#define	GUI_TF	usb_tf
#endif
	sio_rf();
	while (1) {
		if (gl.exit) return;
		if (++i < 21 && (i & 02)) LEDTG();
		else if (i >= 40) i = 0;
		nxt = tic() + DRUPD;
		do GUI_TW(); while ((tmp = nxt - tic()) > 0);
		if (GUI_RC() == C_STRT) break;
#if	U4
		if (CB_NO_D(gl.sio.rxr,gl.sio.rxw)) continue;
		/* USB <-> RS232 serial bridge */
		csisclr();
		while (gl.usb.sofi < 100) {
			while ((rxs = sio_rc()) > 0) usb_sc(rxs);
			usb_tw();
			while ((rxs = usb_rc()) > 0) sio_sc(rxs);
			if ((tmp = nxt - tic()) <= 0)
				LEDTG(), nxt = tic() + MS2TIC(250);
		}
		return;
#endif
	}
	LEDOF();
	gl.dsnd = U4 ? 1 : 0;
AGAIN:
	GUI_TW();
	csisclr();
	csirow(DLN0); csihco(CYAN);
	SND_SP("rx2at ");
	snd_sp(version);
	SND_SP(", at2so ");
	if (gl.arm.adr == 0) SND_SP("not ");
	SND_SP("attached");

	rdcfg(cfg);
	csirow(DLN1);
	csilco(WHITE); SND_SP("cpusg ");
	k = 0x1e;		i = cfg[4]; csihco(i==k?GREEN:RED); snd_sbx(i);
	k = 0x95;		i = cfg[5]; csihco(i==k?GREEN:RED); snd_sbx(i);
	k = U4 ? 0x87:0x0f;	i = cfg[6]; csihco(i==k?GREEN:RED); snd_sbx(i);
	csilco(WHITE); SND_SP(" fuses ");
	snd_sbx(cfg[0]); snd_sc('-');	/* high */
	snd_sbx(cfg[1]); snd_sc('-');	/* low */
	snd_sbx(cfg[2]); snd_sc('-');	/* extended */
	snd_sbx(cfg[3]);		/* lockbits */
	csihco(YELLOW);
	if (S_LAND == S_FMOD) SND_SP(" 1sM"); else SND_SP(" 2sM");
	snd_snx(T_MODE);
	if (RX_CON == 3) snd_sc('S'); else snd_sc('P');

	GUI_TW();
	csirow(DLN2); csilco(WHITE);
	SND_SP(" loop ");
	snd_spd(0,1,TIC2MS10(DRUPD));
	SND_SP("ms, dcnt="); snd_sid(0,gl.dcnt);

	csirow(DLNRXI); csihco(CYAN);
	SND_SP("-RX-  f[ms]  p[ms] value");

	tmr0_setup(0);
GPSCHANGE:
	GUI_TW();
	csirow(DLN3); csilco(WHITE);
	SND_SP("  gps ");
	if (gl.gps.b100) {
		snd_sid(0,gl.gps.b100);
		SND_SP("00 bps");
	}
	csilclr();

	nxt = tic() + DRUPD;
	for (n = 0; !gl.exit; n ^= 01) {
		/* EEPROM update */
		if (gl.eewen < NEL(gl.eedat)) eepr_updt();
		i = gl.gps.tcnt;
		LEDOF();
		do {
			if (CB_HASD(gl.rxs.rsr,gl.rxs.rsw)) rx_proc();
			usb_sq();
			gps_rcv();
		}
		while ((tmp = nxt - tic()) > 0);
		LEDON();
		if (i != gl.gps.tcnt) goto GPSCHANGE;
		nxt = tic() + DRUPD;
		GUI_TW();

		rxs = rx_read();
		beep_sq();
		if (n & 01) {
			for (i = k = 0; i < NEL(gl.rxs.chn); i++) {
				if (!((msk = _BV(i)) & S_SIG)) continue;
				if (GUI_TF() < 48) GUI_TW();
				csirow(DLNRXC+k); k++;
				csihco(rxs&msk?RED:GREEN);
				switch (i) {
				case S_AILE: SND_SP("AILE"); break;
				case S_ELEV: SND_SP("ELEV"); break;
				case S_THRO: SND_SP("THRO"); break;
				case S_RUDD: SND_SP("RUDD"); break;
				case S_GEAR: SND_SP("GEAR"); break;
				case S_AUX1: SND_SP("AUX1"); break;
				}
				csihco(gl.rxs.err&msk?RED:GREEN);
				snd_spd(7,1,TIC2MS10(gl.rxs.ftm));
				snd_spd(7,3,TIC2US(gl.rxs.chn[i].dur));
				snd_sid(-6,gl.rxs.chn[i].val);
				if (rxs == 0) {
					if (i == S_LAND)
						switch (gl.rxs.fms) {
						case FMS_LAND: SND_SP(" LAND"); break;
						case FMS_FM_1: SND_SP(" FM_1"); break;
						case FMS_FM_2: SND_SP(" FM_2"); break;
						case FMS_FM_3: SND_SP(" FM_3"); break;
						default:       SND_SP(" ????"); break;
						}
					if (gl.rxs.fms == FMS_LAND) {
						if (i == SH_THRO) {
							if (gl.rxs.stk & TS_LF) {
								if (gl.rxs.stk & TS_DN)
									SND_SP(" HOME");
#if GSWO_ENA >= 0 && GSWO_SRC == 1
								else if (gl.rxs.stk & TS_UP)
									SND_SP(" ALRM");
#endif
								else	SND_SP(" TRIM");
							}
							else if (gl.rxs.stk & TS_RT) SND_SP(" ESTP");
						}
						if (i == S_THRO) {
							j = gl.cfg;
							if (gl.rxs.stk & TS_UP) {
								if ((j = gl.cfw) < 0) j = gl.cfg;
								if ((gl.rxs.stk & ES_MSK)) csihco(YELLOW);
							}
							SND_SP(" CFG"); snd_snx(j+1);
						}
						if (i == SH_ELEV && !(gl.rxs.stk & TS_UP)) {
							if (gl.rxs.stk & ES_RT) SND_SP(" VID+");
						}
					}
					else {
						if (i == S_LAND && gl.rxs.fsa) {
						     SND_SP(" ANI"); snd_snx(gl.rxs.fsa);
						}
					}
				}
				csilclr();
			}
			SND_SP("\r\n");
		}
		else {
			if (gl.gps.est || CB_HASD(gl.gps.b_r,gl.gps.b_w)) GUI_TW(), su_sgps();
			if (GUI_RC() == C_STRT) goto AGAIN;
		}
	}
#undef	GUI_TW
#undef	GUI_RC
#undef	GUI_TF
}

/*
 * DRONE control loop
 */
void dr_scfg(void)
{
	const char	*p;

	SIO_SP("RX=C,");
	switch (gl.cfg) {
	default:
	case 0: p = cfg1; break;
	case 1: p = cfg2; break;
	case 2: p = cfg3; break;
	case 3: p = cfg4; break;
	}
	sio_sp(p);
	sio_sc('\r');
}

void dr_vlba(void)
{
	if (++gl.vlba.tick < 6) {
		if (VLBA_BLINK && gl.vlba.stat && gl.vlba.tick == 2) VLBOF();
		return;
	}
	gl.vlba.tick = 0;
	switch (gl.vlba.stat) {
	case 0: if (VLBA_THR > 0 && VLBA_THR <= 60 && gl.drm.m2a.cbat <= VLBA_THR) {
			VLBON();
			SIO_SP("RX=B,1");
			gl.vlba.stat = 1;
			break;
		}
		break;
	case 1: if (gl.drm.m2a.cbat > VLBA_THR) {
			VLBOF();
			SIO_SP("RX=B,0");
			gl.vlba.stat = 0;
		}
		else VLBON();
		break;
	}
}

void dr_sgps(void) /* send GPS data to drone */
{
	u08_t	c, r, w;

	if (gl.gps.est) snd_est(), sio_sc('\r');
	r = gl.gps.b_r;
	w = gl.gps.b_w;
	while (CB_HASD(r,w) && sio_tf() >= 80)
		do {
			c = gl.gps.buf[r];
			if (++r >= NEL(gl.gps.buf)) r = 0;
			sio_sc(c);
			if (c == '\r') break;
		}
		while (CB_HASD(r,w));
	gl.gps.b_r = r;
}

void dr_send(u08_t s)
{
	SIO_SP("RX=");
	if (gl.pad < 0) sio_sc('E');
	else if (s == 9) sio_sc('D');
	else snd_sid(0,s==10?gl.rxs.fms:0);
	snd_sid(',',gl.rxs.chn[S_ROL].val);
	snd_sid(',',gl.rxs.chn[S_PTC].val);
	snd_sid(',',gl.rxs.chn[S_GAZ].val);
	snd_sid(',',gl.rxs.chn[S_YAW].val);
	if (gl.rxs.fsa) { /* animation trigger */
		SIO_SP("\rRX=A");
		snd_sid(',',gl.rxs.fsa);
		gl.rxs.fsa = 0;
	}
	sio_sc('\r');
	if (gl.gps.est || CB_HASD(gl.gps.b_r,gl.gps.b_w)) dr_sgps();
	sio_sc('\n');
}

void dr_loop(void)
{
	u08_t	s, i, k, led;
	long	tmp;
	u32_t	nxt;

	gl.rxs.stk = 0;
	led = 0;
	s = i = k = 0;
	/* This is it, this program is talking to the program on the drone now.
	 * s < 3 -> drone configuration, s >= 3 -> TX/RX in charge */
	sio_rf();
	nxt = tic() + DRUPD;
	tmr0_setup(0);	/* get GPS setup going */
	while (1) {
		/* packet to drone */
		dr_send(s);
		/* EEPROM update */
		if (gl.eewen < NEL(gl.eedat)) eepr_updt();

		/* keep loop on track, don't want to be too pushy or late */
		gl.drm.ack = 0;
		do {
			if (CB_HASD(gl.rxs.rsr,gl.rxs.rsw)) rx_proc();
			gps_rcv();
			sio_rcv();
		}
		while ((tmp = nxt - tic()) > 0);
		nxt = tic() + DRUPD;

		gl.rxs.chg = gl.rxs.stk;	/* remember previous */
		rx_read();

		if (s < 3) {	/* drone configuration */
			switch (s) {
			case 0: dr_scfg();
				k = S2LTIC(3.0);
				LEDOF();
				s = 1;
				break;
			case 1: if (gl.drm.ack) s = 2;	/* received C_ACK from drone */
				else if (--k == 0) s = 0, LEDON();
				break;
			case 2: i = 0;
				s = 3;
				break;
			}
			continue;
		}
		/* Arduino LED blink */
#if	NL_AIR
		if (s == 10) LEDOF(); else
#endif
		if (led == 0) LEDTG();
		else if ((led >>= 1) == 0) {
			led = 1<<(5-1);
			if (i < k) LEDON();
			if (++i >= 6) i = 0;
		}
		else LEDOF();

		/* chores */
		dr_vlba();
		beep_sq();

		/* check radio link */
		if (gl.rxs.err) {	/* radio quit or got disconnected from TX */
			led = 0;
			s = 9;
			continue;
		}

		switch (s) {
		/*
		 * drone on ground, or getting there
		 */
		case 3:
			gl.rxs.chg ^= gl.rxs.stk;
			if (gl.rxs.fms == FMS_LAND) {
				if (gl.rxs.chg & TS_RT) {
					if (gl.rxs.stk & TS_RT) /* EMERGENCY */
						gl.pad = -1;
					else	gl.pad =  0;
				}
				else if (gl.rxs.stk & gl.rxs.chg & TS_LF) {
					if (gl.rxs.stk & TS_DN)
						SIO_SP("RX=H\r"); /* HOME */
					else	SIO_SP("RX=T\r"); /* FTRIM */
				}
				if (gl.rxs.stk & TS_UP) { /* show/change config */
					led = 1;
					k = gl.cfg + 1;
					i = 0;
					s = 5;
				}
				else if (gl.rxs.stk & TS_DN) { /* show GPS status */
					if (gl.drm.m2a.sgps >= 0) {
						if (gl.rxs.chg & TS_DN) led = 1;
						k = gl.drm.m2a.sgps;
					}
				}
				else if (gl.rxs.chg & TS_DN) led = 0;
				if (gl.rxs.stk & gl.rxs.chg & ES_RT) /* VZAP */
					SIO_SP("RX=V,Z\r");
				break;
			}
			if (gl.eewen < NEL(gl.eedat)) break;	/* wait for EEPROM write to complete */
			if (gl.rxs.stk != 0) break;		/* all sticks centered for launch */
			if (gl.rxs.chn[S_THRO].val) break;	/* throttle should be dead 0 */
			gl.pad = 1, s = 10;			/* launch */
			SIO_SP("RX=V,1\r");			/* video record on */
			break;
		case 5: /* display/set configuration */
			k = (gl.cfw < 0 ? gl.cfg : gl.cfw) + 1;
			if (gl.rxs.stk & TS_UP) break;
			if (gl.eewen < NEL(gl.eedat))	/* did get changed */
				s = i = 0;		/* send new configuration to drone */
			else	s = 3;
			led = 0;
			break;
		case 9: /* radio loss recovery */
			if (gl.rxs.fms == FMS_LAND) gl.pad = 0;
			s = gl.pad > 0 ? 10 : 3;
			break;
		/*
		 * drone airborne
		 */
		case 10:
			if (gl.rxs.fms != FMS_LAND) break;
			gl.pad = 0;
			SIO_SP("RX=V,0\r"); /* video record off */
			s = 3;
			break;
		}
	}
}

void init(void)
{
extern	u08_t	__bss_start;
extern	u08_t	__bss_end;
	u08_t	i, k, *b = &__bss_start;
	int	n = &__bss_end - &__bss_start;

	cli();
#if	U4
	UDIEN  = 0;
	USBCON = 0;
	UHWCON = 0;
#endif
	while (--n >= 0) *b++ = 0;	/* clear BSS segment */

	for (EECR = 0; gl.eewen < NEL(gl.eedat); gl.eewen++) {
		EEAR = (int)gl.eewen;
		EECR |= _BV(EERE);
		gl.eedat[gl.eewen] = EEDR;
	}
	for (i = k = 0; i < (NEL(gl.eedat)-1); i++) k += gl.eedat[i];
	if (gl.eemag != EE_MAG || gl.eecks != k) gl.cfg = gl.bid = 0;
	gl.cfw = -1;
#if	AT2SO == 1
	at2so_chck();
#endif

}

int main(void)
{
	u08_t	i, j, k;

AGAIN:
	init();

#if	U4 == 0
	/* Nano, ProMini - RC receiver hardware bits on port D[7:2] */
#if	RX_CON == 0
	gl.rxs.chn[S_THRO].msk = _BV(7);
	gl.rxs.chn[S_AILE].msk = _BV(6);
	gl.rxs.chn[S_ELEV].msk = _BV(5);
	gl.rxs.chn[S_RUDD].msk = _BV(4);
	gl.rxs.chn[S_GEAR].msk = _BV(3);
	gl.rxs.chn[S_AUX1].msk = _BV(2);
#elif	RX_CON == 1
	gl.rxs.chn[S_THRO].msk = _BV(2);
	gl.rxs.chn[S_AILE].msk = _BV(3);
	gl.rxs.chn[S_ELEV].msk = _BV(4);
	gl.rxs.chn[S_RUDD].msk = _BV(5);
	gl.rxs.chn[S_GEAR].msk = _BV(6);
	gl.rxs.chn[S_AUX1].msk = _BV(7);
#elif	RX_CON == 2
	/* put your own bit numbers here */
	gl.rxs.chn[S_THRO].msk = _BV(7);
	gl.rxs.chn[S_AILE].msk = _BV(6);
	gl.rxs.chn[S_ELEV].msk = _BV(5);
	gl.rxs.chn[S_RUDD].msk = _BV(4);
	gl.rxs.chn[S_GEAR].msk = _BV(3);
	gl.rxs.chn[S_AUX1].msk = _BV(2);
#elif	RX_CON == 3
#else
#error	"RX_CON bad value"
#endif
#else
	/* MiruPCB - RC receiver hardware bits on port B[6:1] */
#if	RX_CON == 0
	gl.rxs.chn[S_THRO].msk = _BV(1);
	gl.rxs.chn[S_AILE].msk = _BV(2);
	gl.rxs.chn[S_ELEV].msk = _BV(3);
	gl.rxs.chn[S_RUDD].msk = _BV(4);
	gl.rxs.chn[S_GEAR].msk = _BV(5);
	gl.rxs.chn[S_AUX1].msk = _BV(6);
#elif	RX_CON == 1
	gl.rxs.chn[S_THRO].msk = _BV(6);
	gl.rxs.chn[S_AILE].msk = _BV(5);
	gl.rxs.chn[S_ELEV].msk = _BV(4);
	gl.rxs.chn[S_RUDD].msk = _BV(3);
	gl.rxs.chn[S_GEAR].msk = _BV(2);
	gl.rxs.chn[S_AUX1].msk = _BV(1);
#elif	RX_CON == 2
	/* put your own bit numbers here */
	gl.rxs.chn[S_THRO].msk = _BV(1);
	gl.rxs.chn[S_AILE].msk = _BV(2);
	gl.rxs.chn[S_ELEV].msk = _BV(3);
	gl.rxs.chn[S_RUDD].msk = _BV(4);
	gl.rxs.chn[S_GEAR].msk = _BV(5);
	gl.rxs.chn[S_AUX1].msk = _BV(6);
#elif	RX_CON == 3
#else
#error	"RX_CON bad value"
#endif
#endif

	/* dead bands */
	gl.rxs.chn[S_AILE].dbn = MS2TIC(0.04);
	gl.rxs.chn[S_ELEV].dbn = MS2TIC(0.04);
	gl.rxs.chn[S_THRO].dbn = MS2TIC(0.06);
	gl.rxs.chn[S_RUDD].dbn = MS2TIC(0.04);
	gl.rxs.chn[S_GEAR].dbn = MS2TIC(0.20);
	gl.rxs.chn[S_AUX1].dbn = MS2TIC(0.20);

	port_setup();
	LEDON();
	tmr0_setup(0);
	tmr1_setup();
	sio_setup();
	gl.rxs.smp = RXSIG;
	gl.gps.rxi = GPS_RXI_INPUT();
	sei();		/* turn interrupts on */
	msdly_cali();	/* calculates propper gl.dcnt */
	SIO_UCSRB |= _BV(SIO_RXCIE)|_BV(SIO_RXEN)|_BV(SIO_TXEN);	/* turn USART on */
	GPS_RXI_IRQON();	/* enable GPS softserial port */
	PIN_CHG_IRQEN();	/* turn pin change interrupts on */
	LEDOF();

#if	U4
	usb_init();
	ms_dly(500);
	if (gl.usb.ep0a) {
		su_loop();
		while (1) PORTB = 0, DDRB = 0x80; /* hardware reset (RST connected to this pin) */
		goto AGAIN;
	}
	UDIEN  = 0;
	USBCON = 0;
	UHWCON = 0;
#else
	if (SETUP()) {
		sio_rf();
		ms_dly(500);
		su_loop();
		goto AGAIN;
	}
#endif

	/* wait for drone to boot
	 * make sure radio works and has 'sane' state, aka is in LAND */
#define	NS_BOOT	18
#define	NSQUIET	5
	gl.rxs.erx = 255;	/* mark radio down */
	for (i = j = k = 0; 1; ) {
		if (sio_rf() || j < NS_BOOT) i = 0;
		else if (i < NSQUIET) i++;
		if (rx_read()) k = 0;
		else if (gl.rxs.fms != FMS_LAND) k = 1;
		else if (j < NS_BOOT) k = 2;
		else if (i < NSQUIET) k = 3;
		else break; /* all conditions met, go on */
		switch (k) {
		case 0: blip(1); ms_dly(800-50); break; /* radio not ready */
		case 1: blip(2); ms_dly(600-50); break; /* flight mode not LAND */
		case 2: blip(3); ms_dly(400-50); break; /* drone still booting */
		case 3: blip(4); ms_dly(200-50); break; /* drone still talking */
		}
		/* Note: this loop runs on a 1 second pace, need to refresh RX,
		 *       otherwise 'dead signal' detector triggers on rx_read() */
		rx_read(); ms_dly(50);
		if (j < NS_BOOT) j++;
	}

	/* start shell on drone */
	sio_sc('\r'); ms_dly(100); sio_rf();
	sio_sc('\r'); ms_dly( 50); sio_rf(); /* do it twice... */

	LEDON();
	/* look at throttlestick, if it is not centered, user wants to lock out WiFi... */
	k = (gl.rxs.stk & (TS_UP|TS_DN)) ? 1 : 0;
	at2so_exec(k);	/* load/launch companion program on drone */
	LEDOF();

	dr_loop();
	/* NOTREACHED */
	return 0;
}

#if	AT2SO == 1

const u08_t at2so_buf[] PROGMEM = {
0xaa,0x55,0x6c,0x31,0xc4,0xbb,
0x1f,0x8b,0x08,0x00,0x2b,0x59,0x48,0x58,0x02,0x03,0xcd,0x7c,0x7b,0x7c,0x54,0xd5,
0xbd,0xef,0xda,0x7b,0x66,0x92,0x10,0x02,0x4c,0x1e,0x68,0x8c,0x48,0x76,0x62,0x50,
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0x30,0xde,0xff,0x01,0xe6,0x1c,0x9d,0x8d,0xe0,0x54,0x00,0x00,
};
#endif

